SECTIONS
{
    __romPos = 0;
    _gp = 0x801351CC;
    main_ROM_START = __romPos;
    main_VRAM = ADDR(.main);
    /* Hand-adjusted from splat output, exactly as SSSC's was: the
       image is data / code / data (measured — see splat.yaml header),
       so image_bank precedes .text and tail_data follows it. Splat's
       text-first ordering would have laid code at 0x80010100. */
    .main 0x80010100 : AT(main_ROM_START) SUBALIGN(4)
    {
        FILL(0x00000000);
        build/SLUS_009.21/asm/data/image_bank.data.s.o(.data);
        main_TEXT_START = .;
        build/SLUS_009.21/src/pad.c.o(.text);
        build/SLUS_009.21/src/screen.c.o(.text);
        build/SLUS_009.21/src/sound.c.o(.text);
        build/SLUS_009.21/src/castle.c.o(.text);
        build/SLUS_009.21/src/tim.c.o(.text);
        build/SLUS_009.21/src/movie_run.c.o(.text);
        build/SLUS_009.21/src/movie_play.c.o(.text);
        build/SLUS_009.21/src/2mbyte.c.o(.text);
        build/SLUS_009.21/src/libetc_pad.c.o(.text);
        build/SLUS_009.21/src/libetc_vsync_1.c.o(.text);
        build/SLUS_009.21/src/libetc_vsync_2.c.o(.text);
        build/SLUS_009.21/src/libetc_intr_1.c.o(.text);
        build/SLUS_009.21/src/libetc_intr_2.c.o(.text);
        build/SLUS_009.21/src/libetc_intr_3.c.o(.text);
        build/SLUS_009.21/src/libetc_intr_vb_1.c.o(.text);
        build/SLUS_009.21/src/libetc_intr_vb_2.c.o(.text);
        build/SLUS_009.21/src/libetc_intr_dma_1.c.o(.text);
        build/SLUS_009.21/src/libetc_intr_dma_2.c.o(.text);
        build/SLUS_009.21/src/libapi_c57.c.o(.text);
        build/SLUS_009.21/src/libapi_c114.c.o(.text);
        build/SLUS_009.21/src/libapi_a22.c.o(.text);
        build/SLUS_009.21/src/libapi_a23.c.o(.text);
        build/SLUS_009.21/src/libapi_a24.c.o(.text);
        build/SLUS_009.21/src/libapi_a25.c.o(.text);
        build/SLUS_009.21/src/libapi_a36.c.o(.text);
        build/SLUS_009.21/src/libapi_a37.c.o(.text);
        build/SLUS_009.21/src/libapi_a91.c.o(.text);
        build/SLUS_009.21/src/libapi_l10.c.o(.text);
        build/SLUS_009.21/src/libapi_pad_1.c.o(.text);
        build/SLUS_009.21/src/libapi_pad_2.c.o(.text);
        build/SLUS_009.21/src/libapi_pad_3.c.o(.text);
        build/SLUS_009.21/src/libapi_pad_4.c.o(.text);
        build/SLUS_009.21/src/libapi_a18.c.o(.text);
        build/SLUS_009.21/src/libapi_a19.c.o(.text);
        build/SLUS_009.21/src/libapi_a20.c.o(.text);
        build/SLUS_009.21/src/libapi_a21.c.o(.text);
        build/SLUS_009.21/src/libapi_l02.c.o(.text);
        build/SLUS_009.21/src/libapi_l03.c.o(.text);
        build/SLUS_009.21/src/libapi_patch.c.o(.text);
        build/SLUS_009.21/src/libapi_c68.c.o(.text);
        build/SLUS_009.21/src/libapi_chclrpad.c.o(.text);
        build/SLUS_009.21/src/libgpu_font.c.o(.text);
        build/SLUS_009.21/src/libgpu_krom2tim.c.o(.text);
        build/SLUS_009.21/src/libapi_a81.c.o(.text);
        build/SLUS_009.21/src/libgpu_sys_1.c.o(.text);
        build/SLUS_009.21/src/libgpu_sys_2.c.o(.text);
        build/SLUS_009.21/src/libgpu_sys_3.c.o(.text);
        build/SLUS_009.21/src/libgpu_sys_4.c.o(.text);
        build/SLUS_009.21/src/libgpu_sys_5.c.o(.text);
        build/SLUS_009.21/src/libgpu_sys_6.c.o(.text);
        build/SLUS_009.21/src/libgpu_sys_7.c.o(.text);
        build/SLUS_009.21/src/libetc_vmode_1.c.o(.text);
        build/SLUS_009.21/src/libetc_vmode_2.c.o(.text);
        build/SLUS_009.21/src/libapi_c73.c.o(.text);
        build/SLUS_009.21/src/libgpu_ktrans.c.o(.text);
        build/SLUS_009.21/src/libgpu_e00.c.o(.text);
        build/SLUS_009.21/src/libgpu_e02.c.o(.text);
        build/SLUS_009.21/src/libgpu_e03.c.o(.text);
        build/SLUS_009.21/src/libgpu_e04.c.o(.text);
        build/SLUS_009.21/src/libgpu_p00.c.o(.text);
        build/SLUS_009.21/src/libgpu_p01.c.o(.text);
        build/SLUS_009.21/src/libgpu_p06.c.o(.text);
        build/SLUS_009.21/src/libgpu_p09.c.o(.text);
        build/SLUS_009.21/src/libgpu_p10.c.o(.text);
        build/SLUS_009.21/src/libgpu_p16.c.o(.text);
        build/SLUS_009.21/src/libgpu_p17.c.o(.text);
        build/SLUS_009.21/src/libgpu_p18.c.o(.text);
        build/SLUS_009.21/src/libgpu_p20.c.o(.text);
        build/SLUS_009.21/src/libgpu_p26.c.o(.text);
        build/SLUS_009.21/src/libgpu_p27.c.o(.text);
        build/SLUS_009.21/src/libgpu_p41.c.o(.text);
        build/SLUS_009.21/src/libgs_gs_122.c.o(.text);
        build/SLUS_009.21/src/libcd_cdrom.c.o(.text);
        build/SLUS_009.21/src/libcd_event.c.o(.text);
        build/SLUS_009.21/src/libapi_a07.c.o(.text);
        build/SLUS_009.21/src/libcd_sys.c.o(.text);
        build/SLUS_009.21/src/libcd_bios_1.c.o(.text);
        build/SLUS_009.21/src/libcd_bios_2.c.o(.text);
        build/SLUS_009.21/src/libcd_bios_3.c.o(.text);
        build/SLUS_009.21/src/libcd_iso9660.c.o(.text);
        build/SLUS_009.21/src/libcd_cdread.c.o(.text);
        build/SLUS_009.21/src/libcd_cdread2.c.o(.text);
        build/SLUS_009.21/src/libcd_c_002.c.o(.text);
        build/SLUS_009.21/src/libcd_c_003.c.o(.text);
        build/SLUS_009.21/src/libcd_c_004_1.c.o(.text);
        build/SLUS_009.21/src/libcd_c_004_2.c.o(.text);
        build/SLUS_009.21/src/libcd_c_005.c.o(.text);
        build/SLUS_009.21/src/libcd_c_007.c.o(.text);
        build/SLUS_009.21/src/libcd_c_008.c.o(.text);
        build/SLUS_009.21/src/libcd_c_009.c.o(.text);
        build/SLUS_009.21/src/libcd_c_010.c.o(.text);
        build/SLUS_009.21/src/libcd_c_011_1.c.o(.text);
        build/SLUS_009.21/src/libcd_c_011_2.c.o(.text);
        build/SLUS_009.21/src/libcd_s_002.c.o(.text);
        build/SLUS_009.21/src/libpress_libpress_1.c.o(.text);
        build/SLUS_009.21/src/libpress_libpress_2.c.o(.text);
        build/SLUS_009.21/src/libpress_libpress_3.c.o(.text);
        build/SLUS_009.21/src/libpress_libpress_4.c.o(.text);
        build/SLUS_009.21/src/libpress_vlc_c.c.o(.text);
        build/SLUS_009.21/src/libpress_build.c.o(.text);
        build/SLUS_009.21/src/libds_dscb.c.o(.text);
        build/SLUS_009.21/src/libsnd_ut_roff.c.o(.text);
        build/SLUS_009.21/src/libspu_s_ini_1.c.o(.text);
        build/SLUS_009.21/src/libspu_s_ini_2.c.o(.text);
        build/SLUS_009.21/src/libapi_a08.c.o(.text);
        build/SLUS_009.21/src/libapi_a12.c.o(.text);
        build/SLUS_009.21/src/libspu_spu_1.c.o(.text);
        build/SLUS_009.21/src/libspu_spu_2.c.o(.text);
        build/SLUS_009.21/src/libspu_spu_3.c.o(.text);
        build/SLUS_009.21/src/libspu_s_dcb.c.o(.text);
        build/SLUS_009.21/src/libspu_s_m_init.c.o(.text);
        build/SLUS_009.21/src/libspu_s_m_m.c.o(.text);
        build/SLUS_009.21/src/libspu_s_m_int.c.o(.text);
        build/SLUS_009.21/src/libspu_s_snv.c.o(.text);
        build/SLUS_009.21/src/libspu_s_sav.c.o(.text);
        build/SLUS_009.21/src/libspu_s_snc.c.o(.text);
        build/SLUS_009.21/src/libspu_s_sk.c.o(.text);
        build/SLUS_009.21/src/libspu_s_skowa.c.o(.text);
        build/SLUS_009.21/src/libspu_s_r.c.o(.text);
        build/SLUS_009.21/src/libspu_s_stsa.c.o(.text);
        build/SLUS_009.21/src/libspu_s_stm.c.o(.text);
        build/SLUS_009.21/src/libspu_s_itc.c.o(.text);
        build/SLUS_009.21/src/libapi_a11.c.o(.text);
        build/SLUS_009.21/src/libspu_s_sca.c.o(.text);
        build/SLUS_009.21/src/libspu_s_sva.c.o(.text);
        build/SLUS_009.21/src/libspu_s_n2p.c.o(.text);
        build/SLUS_009.21/src/libspu_s_sccv.c.o(.text);
        build/SLUS_009.21/src/libspu_s_sccm.c.o(.text);
        build/SLUS_009.21/src/libpad_padentry_1.c.o(.text);
        build/SLUS_009.21/src/libpad_padentry_2.c.o(.text);
        build/SLUS_009.21/src/libpad_padentry_3.c.o(.text);
        build/SLUS_009.21/src/libpad_padmain_1.c.o(.text);
        build/SLUS_009.21/src/libpad_padmain_2.c.o(.text);
        build/SLUS_009.21/src/libpad_padmain_3.c.o(.text);
        build/SLUS_009.21/src/libpad_padmain_4.c.o(.text);
        build/SLUS_009.21/src/libpad_padmain_5.c.o(.text);
        build/SLUS_009.21/src/libpad_padmain_6.c.o(.text);
        build/SLUS_009.21/src/libpad_padcmd_1.c.o(.text);
        build/SLUS_009.21/src/libpad_padcmd_2.c.o(.text);
        build/SLUS_009.21/src/libpad_padcmd_3.c.o(.text);
        build/SLUS_009.21/src/libpad_padcmd_4.c.o(.text);
        build/SLUS_009.21/src/libpad_padcmd_5.c.o(.text);
        build/SLUS_009.21/src/libpad_padcmd_6.c.o(.text);
        build/SLUS_009.21/src/libpad_padcmd_7.c.o(.text);
        build/SLUS_009.21/src/libpad_padif.c.o(.text);
        build/SLUS_009.21/src/libpad_padportm.c.o(.text);
        build/SLUS_009.21/src/libpad_padseqm_1.c.o(.text);
        build/SLUS_009.21/src/libpad_padseqm_2.c.o(.text);
        build/SLUS_009.21/src/libpad_padseqm_3.c.o(.text);
        build/SLUS_009.21/src/libpad_waitrc2.c.o(.text);
        build/SLUS_009.21/src/libc2_bcopy.c.o(.text);
        build/SLUS_009.21/src/libc2_bzero.c.o(.text);
        build/SLUS_009.21/src/libc2_memcpy.c.o(.text);
        build/SLUS_009.21/src/libc2_memset.c.o(.text);
        build/SLUS_009.21/src/libc2_rand.c.o(.text);
        build/SLUS_009.21/src/libc2_strcmp.c.o(.text);
        build/SLUS_009.21/src/libc2_strlen.c.o(.text);
        build/SLUS_009.21/src/libc2_strncmp.c.o(.text);
        build/SLUS_009.21/src/libc2_printf.c.o(.text);
        build/SLUS_009.21/src/libc2_prnt.c.o(.text);
        build/SLUS_009.21/src/libc2_ctype.c.o(.text);
        build/SLUS_009.21/src/libc2_memchr.c.o(.text);
        build/SLUS_009.21/src/libc2_putchar_1.c.o(.text);
        build/SLUS_009.21/src/libc2_putchar_2.c.o(.text);
        build/SLUS_009.21/src/libc2_putchar_3.c.o(.text);
        build/SLUS_009.21/src/libapi_a53.c.o(.text);
        build/SLUS_009.21/src/libc2_sprintf.c.o(.text);
        build/SLUS_009.21/src/libc_memmove.c.o(.text);
        build/SLUS_009.21/src/libc2_puts.c.o(.text);
        build/SLUS_009.21/src/libc2_setjmp.c.o(.text);
        . = ALIGN(., 16);
        main_TEXT_END = .;
        main_TEXT_SIZE = ABSOLUTE(main_TEXT_END - main_TEXT_START);
        main_DATA_START = .;
        build/SLUS_009.21/src/pad.c.o(.data);
        build/SLUS_009.21/src/screen.c.o(.data);
        build/SLUS_009.21/src/sound.c.o(.data);
        build/SLUS_009.21/src/castle.c.o(.data);
        build/SLUS_009.21/src/tim.c.o(.data);
        build/SLUS_009.21/src/movie_run.c.o(.data);
        build/SLUS_009.21/src/movie_play.c.o(.data);
        build/SLUS_009.21/src/2mbyte.c.o(.data);
        build/SLUS_009.21/src/libetc_pad.c.o(.data);
        build/SLUS_009.21/src/libetc_vsync_1.c.o(.data);
        build/SLUS_009.21/src/libetc_vsync_2.c.o(.data);
        build/SLUS_009.21/src/libetc_intr_1.c.o(.data);
        build/SLUS_009.21/src/libetc_intr_2.c.o(.data);
        build/SLUS_009.21/src/libetc_intr_3.c.o(.data);
        build/SLUS_009.21/src/libetc_intr_vb_1.c.o(.data);
        build/SLUS_009.21/src/libetc_intr_vb_2.c.o(.data);
        build/SLUS_009.21/src/libetc_intr_dma_1.c.o(.data);
        build/SLUS_009.21/src/libetc_intr_dma_2.c.o(.data);
        build/SLUS_009.21/src/libapi_c57.c.o(.data);
        build/SLUS_009.21/src/libapi_c114.c.o(.data);
        build/SLUS_009.21/src/libapi_a22.c.o(.data);
        build/SLUS_009.21/src/libapi_a23.c.o(.data);
        build/SLUS_009.21/src/libapi_a24.c.o(.data);
        build/SLUS_009.21/src/libapi_a25.c.o(.data);
        build/SLUS_009.21/src/libapi_a36.c.o(.data);
        build/SLUS_009.21/src/libapi_a37.c.o(.data);
        build/SLUS_009.21/src/libapi_a91.c.o(.data);
        build/SLUS_009.21/src/libapi_l10.c.o(.data);
        build/SLUS_009.21/src/libapi_pad_1.c.o(.data);
        build/SLUS_009.21/src/libapi_pad_2.c.o(.data);
        build/SLUS_009.21/src/libapi_pad_3.c.o(.data);
        build/SLUS_009.21/src/libapi_pad_4.c.o(.data);
        build/SLUS_009.21/src/libapi_a18.c.o(.data);
        build/SLUS_009.21/src/libapi_a19.c.o(.data);
        build/SLUS_009.21/src/libapi_a20.c.o(.data);
        build/SLUS_009.21/src/libapi_a21.c.o(.data);
        build/SLUS_009.21/src/libapi_l02.c.o(.data);
        build/SLUS_009.21/src/libapi_l03.c.o(.data);
        build/SLUS_009.21/src/libapi_patch.c.o(.data);
        build/SLUS_009.21/src/libapi_c68.c.o(.data);
        build/SLUS_009.21/src/libapi_chclrpad.c.o(.data);
        build/SLUS_009.21/src/libgpu_font.c.o(.data);
        build/SLUS_009.21/src/libgpu_krom2tim.c.o(.data);
        build/SLUS_009.21/src/libapi_a81.c.o(.data);
        build/SLUS_009.21/src/libgpu_sys_1.c.o(.data);
        build/SLUS_009.21/src/libgpu_sys_2.c.o(.data);
        build/SLUS_009.21/src/libgpu_sys_3.c.o(.data);
        build/SLUS_009.21/src/libgpu_sys_4.c.o(.data);
        build/SLUS_009.21/src/libgpu_sys_5.c.o(.data);
        build/SLUS_009.21/src/libgpu_sys_6.c.o(.data);
        build/SLUS_009.21/src/libgpu_sys_7.c.o(.data);
        build/SLUS_009.21/src/libetc_vmode_1.c.o(.data);
        build/SLUS_009.21/src/libetc_vmode_2.c.o(.data);
        build/SLUS_009.21/src/libapi_c73.c.o(.data);
        build/SLUS_009.21/src/libgpu_ktrans.c.o(.data);
        build/SLUS_009.21/src/libgpu_e00.c.o(.data);
        build/SLUS_009.21/src/libgpu_e02.c.o(.data);
        build/SLUS_009.21/src/libgpu_e03.c.o(.data);
        build/SLUS_009.21/src/libgpu_e04.c.o(.data);
        build/SLUS_009.21/src/libgpu_p00.c.o(.data);
        build/SLUS_009.21/src/libgpu_p01.c.o(.data);
        build/SLUS_009.21/src/libgpu_p06.c.o(.data);
        build/SLUS_009.21/src/libgpu_p09.c.o(.data);
        build/SLUS_009.21/src/libgpu_p10.c.o(.data);
        build/SLUS_009.21/src/libgpu_p16.c.o(.data);
        build/SLUS_009.21/src/libgpu_p17.c.o(.data);
        build/SLUS_009.21/src/libgpu_p18.c.o(.data);
        build/SLUS_009.21/src/libgpu_p20.c.o(.data);
        build/SLUS_009.21/src/libgpu_p26.c.o(.data);
        build/SLUS_009.21/src/libgpu_p27.c.o(.data);
        build/SLUS_009.21/src/libgpu_p41.c.o(.data);
        build/SLUS_009.21/src/libgs_gs_122.c.o(.data);
        build/SLUS_009.21/src/libcd_cdrom.c.o(.data);
        build/SLUS_009.21/src/libcd_event.c.o(.data);
        build/SLUS_009.21/src/libapi_a07.c.o(.data);
        build/SLUS_009.21/src/libcd_sys.c.o(.data);
        build/SLUS_009.21/src/libcd_bios_1.c.o(.data);
        build/SLUS_009.21/src/libcd_bios_2.c.o(.data);
        build/SLUS_009.21/src/libcd_bios_3.c.o(.data);
        build/SLUS_009.21/src/libcd_iso9660.c.o(.data);
        build/SLUS_009.21/src/libcd_cdread.c.o(.data);
        build/SLUS_009.21/src/libcd_cdread2.c.o(.data);
        build/SLUS_009.21/src/libcd_c_002.c.o(.data);
        build/SLUS_009.21/src/libcd_c_003.c.o(.data);
        build/SLUS_009.21/src/libcd_c_004_1.c.o(.data);
        build/SLUS_009.21/src/libcd_c_004_2.c.o(.data);
        build/SLUS_009.21/src/libcd_c_005.c.o(.data);
        build/SLUS_009.21/src/libcd_c_007.c.o(.data);
        build/SLUS_009.21/src/libcd_c_008.c.o(.data);
        build/SLUS_009.21/src/libcd_c_009.c.o(.data);
        build/SLUS_009.21/src/libcd_c_010.c.o(.data);
        build/SLUS_009.21/src/libcd_c_011_1.c.o(.data);
        build/SLUS_009.21/src/libcd_c_011_2.c.o(.data);
        build/SLUS_009.21/src/libcd_s_002.c.o(.data);
        build/SLUS_009.21/src/libpress_libpress_1.c.o(.data);
        build/SLUS_009.21/src/libpress_libpress_2.c.o(.data);
        build/SLUS_009.21/src/libpress_libpress_3.c.o(.data);
        build/SLUS_009.21/src/libpress_libpress_4.c.o(.data);
        build/SLUS_009.21/src/libpress_vlc_c.c.o(.data);
        build/SLUS_009.21/src/libpress_build.c.o(.data);
        build/SLUS_009.21/src/libds_dscb.c.o(.data);
        build/SLUS_009.21/src/libsnd_ut_roff.c.o(.data);
        build/SLUS_009.21/src/libspu_s_ini_1.c.o(.data);
        build/SLUS_009.21/src/libspu_s_ini_2.c.o(.data);
        build/SLUS_009.21/src/libapi_a08.c.o(.data);
        build/SLUS_009.21/src/libapi_a12.c.o(.data);
        build/SLUS_009.21/src/libspu_spu_1.c.o(.data);
        build/SLUS_009.21/src/libspu_spu_2.c.o(.data);
        build/SLUS_009.21/src/libspu_spu_3.c.o(.data);
        build/SLUS_009.21/src/libspu_s_dcb.c.o(.data);
        build/SLUS_009.21/src/libspu_s_m_init.c.o(.data);
        build/SLUS_009.21/src/libspu_s_m_m.c.o(.data);
        build/SLUS_009.21/src/libspu_s_m_int.c.o(.data);
        build/SLUS_009.21/src/libspu_s_snv.c.o(.data);
        build/SLUS_009.21/src/libspu_s_sav.c.o(.data);
        build/SLUS_009.21/src/libspu_s_snc.c.o(.data);
        build/SLUS_009.21/src/libspu_s_sk.c.o(.data);
        build/SLUS_009.21/src/libspu_s_skowa.c.o(.data);
        build/SLUS_009.21/src/libspu_s_r.c.o(.data);
        build/SLUS_009.21/src/libspu_s_stsa.c.o(.data);
        build/SLUS_009.21/src/libspu_s_stm.c.o(.data);
        build/SLUS_009.21/src/libspu_s_itc.c.o(.data);
        build/SLUS_009.21/src/libapi_a11.c.o(.data);
        build/SLUS_009.21/src/libspu_s_sca.c.o(.data);
        build/SLUS_009.21/src/libspu_s_sva.c.o(.data);
        build/SLUS_009.21/src/libspu_s_n2p.c.o(.data);
        build/SLUS_009.21/src/libspu_s_sccv.c.o(.data);
        build/SLUS_009.21/src/libspu_s_sccm.c.o(.data);
        build/SLUS_009.21/src/libpad_padentry_1.c.o(.data);
        build/SLUS_009.21/src/libpad_padentry_2.c.o(.data);
        build/SLUS_009.21/src/libpad_padentry_3.c.o(.data);
        build/SLUS_009.21/src/libpad_padmain_1.c.o(.data);
        build/SLUS_009.21/src/libpad_padmain_2.c.o(.data);
        build/SLUS_009.21/src/libpad_padmain_3.c.o(.data);
        build/SLUS_009.21/src/libpad_padmain_4.c.o(.data);
        build/SLUS_009.21/src/libpad_padmain_5.c.o(.data);
        build/SLUS_009.21/src/libpad_padmain_6.c.o(.data);
        build/SLUS_009.21/src/libpad_padcmd_1.c.o(.data);
        build/SLUS_009.21/src/libpad_padcmd_2.c.o(.data);
        build/SLUS_009.21/src/libpad_padcmd_3.c.o(.data);
        build/SLUS_009.21/src/libpad_padcmd_4.c.o(.data);
        build/SLUS_009.21/src/libpad_padcmd_5.c.o(.data);
        build/SLUS_009.21/src/libpad_padcmd_6.c.o(.data);
        build/SLUS_009.21/src/libpad_padcmd_7.c.o(.data);
        build/SLUS_009.21/src/libpad_padif.c.o(.data);
        build/SLUS_009.21/src/libpad_padportm.c.o(.data);
        build/SLUS_009.21/src/libpad_padseqm_1.c.o(.data);
        build/SLUS_009.21/src/libpad_padseqm_2.c.o(.data);
        build/SLUS_009.21/src/libpad_padseqm_3.c.o(.data);
        build/SLUS_009.21/src/libpad_waitrc2.c.o(.data);
        build/SLUS_009.21/src/libc2_bcopy.c.o(.data);
        build/SLUS_009.21/src/libc2_bzero.c.o(.data);
        build/SLUS_009.21/src/libc2_memcpy.c.o(.data);
        build/SLUS_009.21/src/libc2_memset.c.o(.data);
        build/SLUS_009.21/src/libc2_rand.c.o(.data);
        build/SLUS_009.21/src/libc2_strcmp.c.o(.data);
        build/SLUS_009.21/src/libc2_strlen.c.o(.data);
        build/SLUS_009.21/src/libc2_strncmp.c.o(.data);
        build/SLUS_009.21/src/libc2_printf.c.o(.data);
        build/SLUS_009.21/src/libc2_prnt.c.o(.data);
        build/SLUS_009.21/src/libc2_ctype.c.o(.data);
        build/SLUS_009.21/src/libc2_memchr.c.o(.data);
        build/SLUS_009.21/src/libc2_putchar_1.c.o(.data);
        build/SLUS_009.21/src/libc2_putchar_2.c.o(.data);
        build/SLUS_009.21/src/libc2_putchar_3.c.o(.data);
        build/SLUS_009.21/src/libapi_a53.c.o(.data);
        build/SLUS_009.21/src/libc2_sprintf.c.o(.data);
        build/SLUS_009.21/src/libc_memmove.c.o(.data);
        build/SLUS_009.21/src/libc2_puts.c.o(.data);
        build/SLUS_009.21/src/libc2_setjmp.c.o(.data);
        . = ALIGN(., 16);
        build/SLUS_009.21/asm/data/tail_data.data.s.o(.data);
        . = ALIGN(., 16);
        main_DATA_END = .;
        main_DATA_SIZE = ABSOLUTE(main_DATA_END - main_DATA_START);
        main_RODATA_START = .;
        build/SLUS_009.21/src/pad.c.o(.rodata);
        build/SLUS_009.21/src/screen.c.o(.rodata);
        build/SLUS_009.21/src/sound.c.o(.rodata);
        build/SLUS_009.21/src/castle.c.o(.rodata);
        build/SLUS_009.21/src/tim.c.o(.rodata);
        build/SLUS_009.21/src/movie_run.c.o(.rodata);
        build/SLUS_009.21/src/movie_play.c.o(.rodata);
        build/SLUS_009.21/src/2mbyte.c.o(.rodata);
        build/SLUS_009.21/src/libetc_pad.c.o(.rodata);
        build/SLUS_009.21/src/libetc_vsync_1.c.o(.rodata);
        build/SLUS_009.21/src/libetc_vsync_2.c.o(.rodata);
        build/SLUS_009.21/src/libetc_intr_1.c.o(.rodata);
        build/SLUS_009.21/src/libetc_intr_2.c.o(.rodata);
        build/SLUS_009.21/src/libetc_intr_3.c.o(.rodata);
        build/SLUS_009.21/src/libetc_intr_vb_1.c.o(.rodata);
        build/SLUS_009.21/src/libetc_intr_vb_2.c.o(.rodata);
        build/SLUS_009.21/src/libetc_intr_dma_1.c.o(.rodata);
        build/SLUS_009.21/src/libetc_intr_dma_2.c.o(.rodata);
        build/SLUS_009.21/src/libapi_c57.c.o(.rodata);
        build/SLUS_009.21/src/libapi_c114.c.o(.rodata);
        build/SLUS_009.21/src/libapi_a22.c.o(.rodata);
        build/SLUS_009.21/src/libapi_a23.c.o(.rodata);
        build/SLUS_009.21/src/libapi_a24.c.o(.rodata);
        build/SLUS_009.21/src/libapi_a25.c.o(.rodata);
        build/SLUS_009.21/src/libapi_a36.c.o(.rodata);
        build/SLUS_009.21/src/libapi_a37.c.o(.rodata);
        build/SLUS_009.21/src/libapi_a91.c.o(.rodata);
        build/SLUS_009.21/src/libapi_l10.c.o(.rodata);
        build/SLUS_009.21/src/libapi_pad_1.c.o(.rodata);
        build/SLUS_009.21/src/libapi_pad_2.c.o(.rodata);
        build/SLUS_009.21/src/libapi_pad_3.c.o(.rodata);
        build/SLUS_009.21/src/libapi_pad_4.c.o(.rodata);
        build/SLUS_009.21/src/libapi_a18.c.o(.rodata);
        build/SLUS_009.21/src/libapi_a19.c.o(.rodata);
        build/SLUS_009.21/src/libapi_a20.c.o(.rodata);
        build/SLUS_009.21/src/libapi_a21.c.o(.rodata);
        build/SLUS_009.21/src/libapi_l02.c.o(.rodata);
        build/SLUS_009.21/src/libapi_l03.c.o(.rodata);
        build/SLUS_009.21/src/libapi_patch.c.o(.rodata);
        build/SLUS_009.21/src/libapi_c68.c.o(.rodata);
        build/SLUS_009.21/src/libapi_chclrpad.c.o(.rodata);
        build/SLUS_009.21/src/libgpu_font.c.o(.rodata);
        build/SLUS_009.21/src/libgpu_krom2tim.c.o(.rodata);
        build/SLUS_009.21/src/libapi_a81.c.o(.rodata);
        build/SLUS_009.21/src/libgpu_sys_1.c.o(.rodata);
        build/SLUS_009.21/src/libgpu_sys_2.c.o(.rodata);
        build/SLUS_009.21/src/libgpu_sys_3.c.o(.rodata);
        build/SLUS_009.21/src/libgpu_sys_4.c.o(.rodata);
        build/SLUS_009.21/src/libgpu_sys_5.c.o(.rodata);
        build/SLUS_009.21/src/libgpu_sys_6.c.o(.rodata);
        build/SLUS_009.21/src/libgpu_sys_7.c.o(.rodata);
        build/SLUS_009.21/src/libetc_vmode_1.c.o(.rodata);
        build/SLUS_009.21/src/libetc_vmode_2.c.o(.rodata);
        build/SLUS_009.21/src/libapi_c73.c.o(.rodata);
        build/SLUS_009.21/src/libgpu_ktrans.c.o(.rodata);
        build/SLUS_009.21/src/libgpu_e00.c.o(.rodata);
        build/SLUS_009.21/src/libgpu_e02.c.o(.rodata);
        build/SLUS_009.21/src/libgpu_e03.c.o(.rodata);
        build/SLUS_009.21/src/libgpu_e04.c.o(.rodata);
        build/SLUS_009.21/src/libgpu_p00.c.o(.rodata);
        build/SLUS_009.21/src/libgpu_p01.c.o(.rodata);
        build/SLUS_009.21/src/libgpu_p06.c.o(.rodata);
        build/SLUS_009.21/src/libgpu_p09.c.o(.rodata);
        build/SLUS_009.21/src/libgpu_p10.c.o(.rodata);
        build/SLUS_009.21/src/libgpu_p16.c.o(.rodata);
        build/SLUS_009.21/src/libgpu_p17.c.o(.rodata);
        build/SLUS_009.21/src/libgpu_p18.c.o(.rodata);
        build/SLUS_009.21/src/libgpu_p20.c.o(.rodata);
        build/SLUS_009.21/src/libgpu_p26.c.o(.rodata);
        build/SLUS_009.21/src/libgpu_p27.c.o(.rodata);
        build/SLUS_009.21/src/libgpu_p41.c.o(.rodata);
        build/SLUS_009.21/src/libgs_gs_122.c.o(.rodata);
        build/SLUS_009.21/src/libcd_cdrom.c.o(.rodata);
        build/SLUS_009.21/src/libcd_event.c.o(.rodata);
        build/SLUS_009.21/src/libapi_a07.c.o(.rodata);
        build/SLUS_009.21/src/libcd_sys.c.o(.rodata);
        build/SLUS_009.21/src/libcd_bios_1.c.o(.rodata);
        build/SLUS_009.21/src/libcd_bios_2.c.o(.rodata);
        build/SLUS_009.21/src/libcd_bios_3.c.o(.rodata);
        build/SLUS_009.21/src/libcd_iso9660.c.o(.rodata);
        build/SLUS_009.21/src/libcd_cdread.c.o(.rodata);
        build/SLUS_009.21/src/libcd_cdread2.c.o(.rodata);
        build/SLUS_009.21/src/libcd_c_002.c.o(.rodata);
        build/SLUS_009.21/src/libcd_c_003.c.o(.rodata);
        build/SLUS_009.21/src/libcd_c_004_1.c.o(.rodata);
        build/SLUS_009.21/src/libcd_c_004_2.c.o(.rodata);
        build/SLUS_009.21/src/libcd_c_005.c.o(.rodata);
        build/SLUS_009.21/src/libcd_c_007.c.o(.rodata);
        build/SLUS_009.21/src/libcd_c_008.c.o(.rodata);
        build/SLUS_009.21/src/libcd_c_009.c.o(.rodata);
        build/SLUS_009.21/src/libcd_c_010.c.o(.rodata);
        build/SLUS_009.21/src/libcd_c_011_1.c.o(.rodata);
        build/SLUS_009.21/src/libcd_c_011_2.c.o(.rodata);
        build/SLUS_009.21/src/libcd_s_002.c.o(.rodata);
        build/SLUS_009.21/src/libpress_libpress_1.c.o(.rodata);
        build/SLUS_009.21/src/libpress_libpress_2.c.o(.rodata);
        build/SLUS_009.21/src/libpress_libpress_3.c.o(.rodata);
        build/SLUS_009.21/src/libpress_libpress_4.c.o(.rodata);
        build/SLUS_009.21/src/libpress_vlc_c.c.o(.rodata);
        build/SLUS_009.21/src/libpress_build.c.o(.rodata);
        build/SLUS_009.21/src/libds_dscb.c.o(.rodata);
        build/SLUS_009.21/src/libsnd_ut_roff.c.o(.rodata);
        build/SLUS_009.21/src/libspu_s_ini_1.c.o(.rodata);
        build/SLUS_009.21/src/libspu_s_ini_2.c.o(.rodata);
        build/SLUS_009.21/src/libapi_a08.c.o(.rodata);
        build/SLUS_009.21/src/libapi_a12.c.o(.rodata);
        build/SLUS_009.21/src/libspu_spu_1.c.o(.rodata);
        build/SLUS_009.21/src/libspu_spu_2.c.o(.rodata);
        build/SLUS_009.21/src/libspu_spu_3.c.o(.rodata);
        build/SLUS_009.21/src/libspu_s_dcb.c.o(.rodata);
        build/SLUS_009.21/src/libspu_s_m_init.c.o(.rodata);
        build/SLUS_009.21/src/libspu_s_m_m.c.o(.rodata);
        build/SLUS_009.21/src/libspu_s_m_int.c.o(.rodata);
        build/SLUS_009.21/src/libspu_s_snv.c.o(.rodata);
        build/SLUS_009.21/src/libspu_s_sav.c.o(.rodata);
        build/SLUS_009.21/src/libspu_s_snc.c.o(.rodata);
        build/SLUS_009.21/src/libspu_s_sk.c.o(.rodata);
        build/SLUS_009.21/src/libspu_s_skowa.c.o(.rodata);
        build/SLUS_009.21/src/libspu_s_r.c.o(.rodata);
        build/SLUS_009.21/src/libspu_s_stsa.c.o(.rodata);
        build/SLUS_009.21/src/libspu_s_stm.c.o(.rodata);
        build/SLUS_009.21/src/libspu_s_itc.c.o(.rodata);
        build/SLUS_009.21/src/libapi_a11.c.o(.rodata);
        build/SLUS_009.21/src/libspu_s_sca.c.o(.rodata);
        build/SLUS_009.21/src/libspu_s_sva.c.o(.rodata);
        build/SLUS_009.21/src/libspu_s_n2p.c.o(.rodata);
        build/SLUS_009.21/src/libspu_s_sccv.c.o(.rodata);
        build/SLUS_009.21/src/libspu_s_sccm.c.o(.rodata);
        build/SLUS_009.21/src/libpad_padentry_1.c.o(.rodata);
        build/SLUS_009.21/src/libpad_padentry_2.c.o(.rodata);
        build/SLUS_009.21/src/libpad_padentry_3.c.o(.rodata);
        build/SLUS_009.21/src/libpad_padmain_1.c.o(.rodata);
        build/SLUS_009.21/src/libpad_padmain_2.c.o(.rodata);
        build/SLUS_009.21/src/libpad_padmain_3.c.o(.rodata);
        build/SLUS_009.21/src/libpad_padmain_4.c.o(.rodata);
        build/SLUS_009.21/src/libpad_padmain_5.c.o(.rodata);
        build/SLUS_009.21/src/libpad_padmain_6.c.o(.rodata);
        build/SLUS_009.21/src/libpad_padcmd_1.c.o(.rodata);
        build/SLUS_009.21/src/libpad_padcmd_2.c.o(.rodata);
        build/SLUS_009.21/src/libpad_padcmd_3.c.o(.rodata);
        build/SLUS_009.21/src/libpad_padcmd_4.c.o(.rodata);
        build/SLUS_009.21/src/libpad_padcmd_5.c.o(.rodata);
        build/SLUS_009.21/src/libpad_padcmd_6.c.o(.rodata);
        build/SLUS_009.21/src/libpad_padcmd_7.c.o(.rodata);
        build/SLUS_009.21/src/libpad_padif.c.o(.rodata);
        build/SLUS_009.21/src/libpad_padportm.c.o(.rodata);
        build/SLUS_009.21/src/libpad_padseqm_1.c.o(.rodata);
        build/SLUS_009.21/src/libpad_padseqm_2.c.o(.rodata);
        build/SLUS_009.21/src/libpad_padseqm_3.c.o(.rodata);
        build/SLUS_009.21/src/libpad_waitrc2.c.o(.rodata);
        build/SLUS_009.21/src/libc2_bcopy.c.o(.rodata);
        build/SLUS_009.21/src/libc2_bzero.c.o(.rodata);
        build/SLUS_009.21/src/libc2_memcpy.c.o(.rodata);
        build/SLUS_009.21/src/libc2_memset.c.o(.rodata);
        build/SLUS_009.21/src/libc2_rand.c.o(.rodata);
        build/SLUS_009.21/src/libc2_strcmp.c.o(.rodata);
        build/SLUS_009.21/src/libc2_strlen.c.o(.rodata);
        build/SLUS_009.21/src/libc2_strncmp.c.o(.rodata);
        build/SLUS_009.21/src/libc2_printf.c.o(.rodata);
        build/SLUS_009.21/src/libc2_prnt.c.o(.rodata);
        build/SLUS_009.21/src/libc2_ctype.c.o(.rodata);
        build/SLUS_009.21/src/libc2_memchr.c.o(.rodata);
        build/SLUS_009.21/src/libc2_putchar_1.c.o(.rodata);
        build/SLUS_009.21/src/libc2_putchar_2.c.o(.rodata);
        build/SLUS_009.21/src/libc2_putchar_3.c.o(.rodata);
        build/SLUS_009.21/src/libapi_a53.c.o(.rodata);
        build/SLUS_009.21/src/libc2_sprintf.c.o(.rodata);
        build/SLUS_009.21/src/libc_memmove.c.o(.rodata);
        build/SLUS_009.21/src/libc2_puts.c.o(.rodata);
        build/SLUS_009.21/src/libc2_setjmp.c.o(.rodata);
        . = ALIGN(., 16);
        main_RODATA_END = .;
        main_RODATA_SIZE = ABSOLUTE(main_RODATA_END - main_RODATA_START);
        main_BSS_START = .;
        build/SLUS_009.21/src/pad.c.o(.bss);
        build/SLUS_009.21/src/screen.c.o(.bss);
        build/SLUS_009.21/src/sound.c.o(.bss);
        build/SLUS_009.21/src/castle.c.o(.bss);
        build/SLUS_009.21/src/tim.c.o(.bss);
        build/SLUS_009.21/src/movie_run.c.o(.bss);
        build/SLUS_009.21/src/movie_play.c.o(.bss);
        build/SLUS_009.21/src/2mbyte.c.o(.bss);
        build/SLUS_009.21/src/libetc_pad.c.o(.bss);
        build/SLUS_009.21/src/libetc_vsync_1.c.o(.bss);
        build/SLUS_009.21/src/libetc_vsync_2.c.o(.bss);
        build/SLUS_009.21/src/libetc_intr_1.c.o(.bss);
        build/SLUS_009.21/src/libetc_intr_2.c.o(.bss);
        build/SLUS_009.21/src/libetc_intr_3.c.o(.bss);
        build/SLUS_009.21/src/libetc_intr_vb_1.c.o(.bss);
        build/SLUS_009.21/src/libetc_intr_vb_2.c.o(.bss);
        build/SLUS_009.21/src/libetc_intr_dma_1.c.o(.bss);
        build/SLUS_009.21/src/libetc_intr_dma_2.c.o(.bss);
        build/SLUS_009.21/src/libapi_c57.c.o(.bss);
        build/SLUS_009.21/src/libapi_c114.c.o(.bss);
        build/SLUS_009.21/src/libapi_a22.c.o(.bss);
        build/SLUS_009.21/src/libapi_a23.c.o(.bss);
        build/SLUS_009.21/src/libapi_a24.c.o(.bss);
        build/SLUS_009.21/src/libapi_a25.c.o(.bss);
        build/SLUS_009.21/src/libapi_a36.c.o(.bss);
        build/SLUS_009.21/src/libapi_a37.c.o(.bss);
        build/SLUS_009.21/src/libapi_a91.c.o(.bss);
        build/SLUS_009.21/src/libapi_l10.c.o(.bss);
        build/SLUS_009.21/src/libapi_pad_1.c.o(.bss);
        build/SLUS_009.21/src/libapi_pad_2.c.o(.bss);
        build/SLUS_009.21/src/libapi_pad_3.c.o(.bss);
        build/SLUS_009.21/src/libapi_pad_4.c.o(.bss);
        build/SLUS_009.21/src/libapi_a18.c.o(.bss);
        build/SLUS_009.21/src/libapi_a19.c.o(.bss);
        build/SLUS_009.21/src/libapi_a20.c.o(.bss);
        build/SLUS_009.21/src/libapi_a21.c.o(.bss);
        build/SLUS_009.21/src/libapi_l02.c.o(.bss);
        build/SLUS_009.21/src/libapi_l03.c.o(.bss);
        build/SLUS_009.21/src/libapi_patch.c.o(.bss);
        build/SLUS_009.21/src/libapi_c68.c.o(.bss);
        build/SLUS_009.21/src/libapi_chclrpad.c.o(.bss);
        build/SLUS_009.21/src/libgpu_font.c.o(.bss);
        build/SLUS_009.21/src/libgpu_krom2tim.c.o(.bss);
        build/SLUS_009.21/src/libapi_a81.c.o(.bss);
        build/SLUS_009.21/src/libgpu_sys_1.c.o(.bss);
        build/SLUS_009.21/src/libgpu_sys_2.c.o(.bss);
        build/SLUS_009.21/src/libgpu_sys_3.c.o(.bss);
        build/SLUS_009.21/src/libgpu_sys_4.c.o(.bss);
        build/SLUS_009.21/src/libgpu_sys_5.c.o(.bss);
        build/SLUS_009.21/src/libgpu_sys_6.c.o(.bss);
        build/SLUS_009.21/src/libgpu_sys_7.c.o(.bss);
        build/SLUS_009.21/src/libetc_vmode_1.c.o(.bss);
        build/SLUS_009.21/src/libetc_vmode_2.c.o(.bss);
        build/SLUS_009.21/src/libapi_c73.c.o(.bss);
        build/SLUS_009.21/src/libgpu_ktrans.c.o(.bss);
        build/SLUS_009.21/src/libgpu_e00.c.o(.bss);
        build/SLUS_009.21/src/libgpu_e02.c.o(.bss);
        build/SLUS_009.21/src/libgpu_e03.c.o(.bss);
        build/SLUS_009.21/src/libgpu_e04.c.o(.bss);
        build/SLUS_009.21/src/libgpu_p00.c.o(.bss);
        build/SLUS_009.21/src/libgpu_p01.c.o(.bss);
        build/SLUS_009.21/src/libgpu_p06.c.o(.bss);
        build/SLUS_009.21/src/libgpu_p09.c.o(.bss);
        build/SLUS_009.21/src/libgpu_p10.c.o(.bss);
        build/SLUS_009.21/src/libgpu_p16.c.o(.bss);
        build/SLUS_009.21/src/libgpu_p17.c.o(.bss);
        build/SLUS_009.21/src/libgpu_p18.c.o(.bss);
        build/SLUS_009.21/src/libgpu_p20.c.o(.bss);
        build/SLUS_009.21/src/libgpu_p26.c.o(.bss);
        build/SLUS_009.21/src/libgpu_p27.c.o(.bss);
        build/SLUS_009.21/src/libgpu_p41.c.o(.bss);
        build/SLUS_009.21/src/libgs_gs_122.c.o(.bss);
        build/SLUS_009.21/src/libcd_cdrom.c.o(.bss);
        build/SLUS_009.21/src/libcd_event.c.o(.bss);
        build/SLUS_009.21/src/libapi_a07.c.o(.bss);
        build/SLUS_009.21/src/libcd_sys.c.o(.bss);
        build/SLUS_009.21/src/libcd_bios_1.c.o(.bss);
        build/SLUS_009.21/src/libcd_bios_2.c.o(.bss);
        build/SLUS_009.21/src/libcd_bios_3.c.o(.bss);
        build/SLUS_009.21/src/libcd_iso9660.c.o(.bss);
        build/SLUS_009.21/src/libcd_cdread.c.o(.bss);
        build/SLUS_009.21/src/libcd_cdread2.c.o(.bss);
        build/SLUS_009.21/src/libcd_c_002.c.o(.bss);
        build/SLUS_009.21/src/libcd_c_003.c.o(.bss);
        build/SLUS_009.21/src/libcd_c_004_1.c.o(.bss);
        build/SLUS_009.21/src/libcd_c_004_2.c.o(.bss);
        build/SLUS_009.21/src/libcd_c_005.c.o(.bss);
        build/SLUS_009.21/src/libcd_c_007.c.o(.bss);
        build/SLUS_009.21/src/libcd_c_008.c.o(.bss);
        build/SLUS_009.21/src/libcd_c_009.c.o(.bss);
        build/SLUS_009.21/src/libcd_c_010.c.o(.bss);
        build/SLUS_009.21/src/libcd_c_011_1.c.o(.bss);
        build/SLUS_009.21/src/libcd_c_011_2.c.o(.bss);
        build/SLUS_009.21/src/libcd_s_002.c.o(.bss);
        build/SLUS_009.21/src/libpress_libpress_1.c.o(.bss);
        build/SLUS_009.21/src/libpress_libpress_2.c.o(.bss);
        build/SLUS_009.21/src/libpress_libpress_3.c.o(.bss);
        build/SLUS_009.21/src/libpress_libpress_4.c.o(.bss);
        build/SLUS_009.21/src/libpress_vlc_c.c.o(.bss);
        build/SLUS_009.21/src/libpress_build.c.o(.bss);
        build/SLUS_009.21/src/libds_dscb.c.o(.bss);
        build/SLUS_009.21/src/libsnd_ut_roff.c.o(.bss);
        build/SLUS_009.21/src/libspu_s_ini_1.c.o(.bss);
        build/SLUS_009.21/src/libspu_s_ini_2.c.o(.bss);
        build/SLUS_009.21/src/libapi_a08.c.o(.bss);
        build/SLUS_009.21/src/libapi_a12.c.o(.bss);
        build/SLUS_009.21/src/libspu_spu_1.c.o(.bss);
        build/SLUS_009.21/src/libspu_spu_2.c.o(.bss);
        build/SLUS_009.21/src/libspu_spu_3.c.o(.bss);
        build/SLUS_009.21/src/libspu_s_dcb.c.o(.bss);
        build/SLUS_009.21/src/libspu_s_m_init.c.o(.bss);
        build/SLUS_009.21/src/libspu_s_m_m.c.o(.bss);
        build/SLUS_009.21/src/libspu_s_m_int.c.o(.bss);
        build/SLUS_009.21/src/libspu_s_snv.c.o(.bss);
        build/SLUS_009.21/src/libspu_s_sav.c.o(.bss);
        build/SLUS_009.21/src/libspu_s_snc.c.o(.bss);
        build/SLUS_009.21/src/libspu_s_sk.c.o(.bss);
        build/SLUS_009.21/src/libspu_s_skowa.c.o(.bss);
        build/SLUS_009.21/src/libspu_s_r.c.o(.bss);
        build/SLUS_009.21/src/libspu_s_stsa.c.o(.bss);
        build/SLUS_009.21/src/libspu_s_stm.c.o(.bss);
        build/SLUS_009.21/src/libspu_s_itc.c.o(.bss);
        build/SLUS_009.21/src/libapi_a11.c.o(.bss);
        build/SLUS_009.21/src/libspu_s_sca.c.o(.bss);
        build/SLUS_009.21/src/libspu_s_sva.c.o(.bss);
        build/SLUS_009.21/src/libspu_s_n2p.c.o(.bss);
        build/SLUS_009.21/src/libspu_s_sccv.c.o(.bss);
        build/SLUS_009.21/src/libspu_s_sccm.c.o(.bss);
        build/SLUS_009.21/src/libpad_padentry_1.c.o(.bss);
        build/SLUS_009.21/src/libpad_padentry_2.c.o(.bss);
        build/SLUS_009.21/src/libpad_padentry_3.c.o(.bss);
        build/SLUS_009.21/src/libpad_padmain_1.c.o(.bss);
        build/SLUS_009.21/src/libpad_padmain_2.c.o(.bss);
        build/SLUS_009.21/src/libpad_padmain_3.c.o(.bss);
        build/SLUS_009.21/src/libpad_padmain_4.c.o(.bss);
        build/SLUS_009.21/src/libpad_padmain_5.c.o(.bss);
        build/SLUS_009.21/src/libpad_padmain_6.c.o(.bss);
        build/SLUS_009.21/src/libpad_padcmd_1.c.o(.bss);
        build/SLUS_009.21/src/libpad_padcmd_2.c.o(.bss);
        build/SLUS_009.21/src/libpad_padcmd_3.c.o(.bss);
        build/SLUS_009.21/src/libpad_padcmd_4.c.o(.bss);
        build/SLUS_009.21/src/libpad_padcmd_5.c.o(.bss);
        build/SLUS_009.21/src/libpad_padcmd_6.c.o(.bss);
        build/SLUS_009.21/src/libpad_padcmd_7.c.o(.bss);
        build/SLUS_009.21/src/libpad_padif.c.o(.bss);
        build/SLUS_009.21/src/libpad_padportm.c.o(.bss);
        build/SLUS_009.21/src/libpad_padseqm_1.c.o(.bss);
        build/SLUS_009.21/src/libpad_padseqm_2.c.o(.bss);
        build/SLUS_009.21/src/libpad_padseqm_3.c.o(.bss);
        build/SLUS_009.21/src/libpad_waitrc2.c.o(.bss);
        build/SLUS_009.21/src/libc2_bcopy.c.o(.bss);
        build/SLUS_009.21/src/libc2_bzero.c.o(.bss);
        build/SLUS_009.21/src/libc2_memcpy.c.o(.bss);
        build/SLUS_009.21/src/libc2_memset.c.o(.bss);
        build/SLUS_009.21/src/libc2_rand.c.o(.bss);
        build/SLUS_009.21/src/libc2_strcmp.c.o(.bss);
        build/SLUS_009.21/src/libc2_strlen.c.o(.bss);
        build/SLUS_009.21/src/libc2_strncmp.c.o(.bss);
        build/SLUS_009.21/src/libc2_printf.c.o(.bss);
        build/SLUS_009.21/src/libc2_prnt.c.o(.bss);
        build/SLUS_009.21/src/libc2_ctype.c.o(.bss);
        build/SLUS_009.21/src/libc2_memchr.c.o(.bss);
        build/SLUS_009.21/src/libc2_putchar_1.c.o(.bss);
        build/SLUS_009.21/src/libc2_putchar_2.c.o(.bss);
        build/SLUS_009.21/src/libc2_putchar_3.c.o(.bss);
        build/SLUS_009.21/src/libapi_a53.c.o(.bss);
        build/SLUS_009.21/src/libc2_sprintf.c.o(.bss);
        build/SLUS_009.21/src/libc_memmove.c.o(.bss);
        build/SLUS_009.21/src/libc2_puts.c.o(.bss);
        build/SLUS_009.21/src/libc2_setjmp.c.o(.bss);
        . = ALIGN(., 16);
        main_BSS_END = .;
        main_BSS_SIZE = ABSOLUTE(main_BSS_END - main_BSS_START);
    }
    __romPos += SIZEOF(.main);
    __romPos = ALIGN(__romPos, 16);
    . = ALIGN(., 16);
    main_ROM_END = __romPos;
    main_VRAM_END = .;

    /DISCARD/ :
    {
        *(*);
    }
}
