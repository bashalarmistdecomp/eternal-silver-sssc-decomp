SECTIONS
{
    __romPos = 0;
    _gp = 0x800B8540;
    main_ROM_START = __romPos;
    main_VRAM = ADDR(.main);
    /* Hand-adjusted from splat output: boot_data precedes .text in the
       original file (ROM 0x0-0x2C4C), and SUBALIGN must be 4 because the
       text start 0x80013C4C is not 16-aligned. */
    .main 0x80011000 : AT(main_ROM_START) SUBALIGN(4)
    {
        FILL(0x00000000);
        build/SLUS_006.28/asm/data/data_D_80011000.s.o(.data);
        build/SLUS_006.28/src/bg_tile.c.o(.rodata);
        build/SLUS_006.28/src/packet_shape.c.o(.rodata);
        build/SLUS_006.28/src/message_draw.c.o(.rodata);
        build/SLUS_006.28/src/start_picture.c.o(.rodata);
        build/SLUS_006.28/src/font_cell.c.o(.rodata);
        build/SLUS_006.28/src/sprite_draw.c.o(.rodata);
        build/SLUS_006.28/src/btl_draw.c.o(.rodata);
        build/SLUS_006.28/src/sprite_list.c.o(.rodata);
        build/SLUS_006.28/src/icon.c.o(.rodata);
        build/SLUS_006.28/asm/data/boot_data.data_80011020_80011038.s.o(.data);
        build/SLUS_006.28/src/data_D_80011054.c.o(.data);
        build/SLUS_006.28/asm/data/data_D_80011060.s.o(.data);
        build/SLUS_006.28/asm/data/boot_data.data_80011020_80011054_80011060_800110C4.s.o(.data);
        build/SLUS_006.28/src/exception.c.o(.rodata);
        build/SLUS_006.28/src/face.c.o(.rodata);
        build/SLUS_006.28/src/cd_track.c.o(.rodata);
        build/SLUS_006.28/src/outline.c.o(.rodata);
        build/SLUS_006.28/src/screen_fade.c.o(.rodata);
        build/SLUS_006.28/src/layer_grey.c.o(.rodata);
        build/SLUS_006.28/src/rng.c.o(.rodata);
        build/SLUS_006.28/src/mth_curv.c.o(.rodata);
        build/SLUS_006.28/src/tile_layer.c.o(.rodata);
        build/SLUS_006.28/src/layer_col.c.o(.rodata);
        build/SLUS_006.28/src/frame.c.o(.rodata);
        build/SLUS_006.28/src/pad_update.c.o(.rodata);
        build/SLUS_006.28/asm/data/boot_data.data_80011020_80011054_80011060_800110C4_80011514_80011548.s.o(.data);
        build/SLUS_006.28/src/pad_start.c.o(.rodata);
        build/SLUS_006.28/src/palette_buf.c.o(.rodata);
        build/SLUS_006.28/src/resource_load.c.o(.rodata);
        build/SLUS_006.28/src/tpage.c.o(.rodata);
        build/SLUS_006.28/src/palette_row.c.o(.rodata);
        build/SLUS_006.28/src/resource_command.c.o(.rodata);
        build/SLUS_006.28/src/map_resource.c.o(.rodata);
        build/SLUS_006.28/src/cdread.c.o(.rodata);
        build/SLUS_006.28/src/fmt.c.o(.rodata);
        build/SLUS_006.28/src/inflate.c.o(.rodata);
        build/SLUS_006.28/src/xmalloc.c.o(.rodata);
        build/SLUS_006.28/asm/data/boot_data.data_80011020_80011054_80011060_800110C4_80011558_800115A0.s.o(.data);
        build/SLUS_006.28/asm/data/data_D_800115E0.s.o(.data);
        build/SLUS_006.28/asm/data/boot_data.data_80011020_80011054_80011060_800110C4_800115E0_80011608.s.o(.data);
        build/SLUS_006.28/src/overlay.c.o(.rodata);
        build/SLUS_006.28/src/xa.c.o(.rodata);
        build/SLUS_006.28/src/sound.c.o(.rodata);
        build/SLUS_006.28/src/picture.c.o(.rodata);
        build/SLUS_006.28/src/cd_change.c.o(.rodata);
        build/SLUS_006.28/src/card.c.o(.rodata);
        build/SLUS_006.28/src/packet_sprite.c.o(.rodata);
        build/SLUS_006.28/src/ankprint.c.o(.rodata);
        build/SLUS_006.28/src/profile.c.o(.rodata);
        build/SLUS_006.28/src/screen_wait.c.o(.rodata);
        build/SLUS_006.28/src/mem_move.c.o(.rodata);
        build/SLUS_006.28/src/palette_animation.c.o(.rodata);
        build/SLUS_006.28/src/tile_animation.c.o(.rodata);
        build/SLUS_006.28/src/pad_record.c.o(.rodata);
        build/SLUS_006.28/src/font_string.c.o(.rodata);
        build/SLUS_006.28/src/btl_animation.c.o(.rodata);
        build/SLUS_006.28/src/btl_run.c.o(.rodata);
        build/SLUS_006.28/src/chr_levelup.c.o(.rodata);
        build/SLUS_006.28/src/btl_end.c.o(.rodata);
        build/SLUS_006.28/src/btl_round.c.o(.rodata);
        build/SLUS_006.28/asm/data/boot_data.data_80011020_80011054_80011060_800110C4_800115E0_80011608_800118C8_800118DC_8001190C_800119A4_800119B8.s.o(.data);
        build/SLUS_006.28/src/btl_init.c.o(.rodata);
        build/SLUS_006.28/src/btl_walk.c.o(.rodata);
        build/SLUS_006.28/src/btl_path.c.o(.rodata);
        build/SLUS_006.28/src/btl_action.c.o(.rodata);
        build/SLUS_006.28/src/btl_status.c.o(.rodata);
        build/SLUS_006.28/src/btl_hit.c.o(.rodata);
        build/SLUS_006.28/src/btl_attack.c.o(.rodata);
        build/SLUS_006.28/src/btl_row.c.o(.rodata);
        build/SLUS_006.28/src/btl_target.c.o(.rodata);
        build/SLUS_006.28/src/btl_move.c.o(.rodata);
        build/SLUS_006.28/src/btl_slot.c.o(.rodata);
        build/SLUS_006.28/src/btl_fall.c.o(.rodata);
        build/SLUS_006.28/src/btl_frame.c.o(.rodata);
        build/SLUS_006.28/src/btl_pick.c.o(.rodata);
        build/SLUS_006.28/src/btl_acting.c.o(.rodata);
        build/SLUS_006.28/src/btl_enemy.c.o(.rodata);
        build/SLUS_006.28/src/btl_outcome.c.o(.rodata);
        build/SLUS_006.28/src/btl_plan.c.o(.rodata);
        build/SLUS_006.28/src/start_screen.c.o(.rodata);
        build/SLUS_006.28/src/btl_menu.c.o(.rodata);
        build/SLUS_006.28/src/btl_command.c.o(.rodata);
        build/SLUS_006.28/src/btl_window.c.o(.rodata);
        build/SLUS_006.28/src/btl_amount.c.o(.rodata);
        build/SLUS_006.28/src/btl_panel.c.o(.rodata);
        build/SLUS_006.28/src/btl_message.c.o(.rodata);
        build/SLUS_006.28/src/btl_choice.c.o(.rodata);
        build/SLUS_006.28/src/shop_run.c.o(.rodata);
        build/SLUS_006.28/src/shop_screen.c.o(.rodata);
        build/SLUS_006.28/asm/data/data_D_800127B8.s.o(.data);
        build/SLUS_006.28/asm/data/boot_data.data_80011020_80011054_80011060_800110C4_800127B8_800127FC.s.o(.data);
        build/SLUS_006.28/src/chr_worn.c.o(.rodata);
        build/SLUS_006.28/src/map_music.c.o(.rodata);
        build/SLUS_006.28/src/movie.c.o(.rodata);
        build/SLUS_006.28/asm/data/boot_data.data_80011020_80011054_80011060_800110C4_800127B8_800127FC_8001286C_8001288C_800128B4.s.o(.data);
        build/SLUS_006.28/src/map_attribute.c.o(.rodata);
        build/SLUS_006.28/asm/data/boot_data.data_80011020_80011054_80011060_800110C4_800127B8_800127FC_8001286C_8001288C_800128B4_80012918_8001293C.s.o(.data);
        build/SLUS_006.28/src/map_change.c.o(.rodata);
        build/SLUS_006.28/src/script_run.c.o(.rodata);
        build/SLUS_006.28/src/message_disp.c.o(.rodata);
        build/SLUS_006.28/src/lns_intp.c.o(.rodata);
        build/SLUS_006.28/asm/data/data_D_80012B70.s.o(.data);
        build/SLUS_006.28/asm/data/boot_data.data_80011020_80011054_80011060_800110C4_800127B8_800127FC_80012B70_80012B84.s.o(.data);
        build/SLUS_006.28/src/lns_move.c.o(.rodata);
        build/SLUS_006.28/src/script_move.c.o(.rodata);
        build/SLUS_006.28/src/move_command.c.o(.rodata);
        build/SLUS_006.28/src/step_command.c.o(.rodata);
        build/SLUS_006.28/asm/data/boot_data.data_80011020_80011054_80011060_800110C4_800127B8_800127FC_80012B70_80012B84_80012BD0_80012BF4.s.o(.data);
        build/SLUS_006.28/src/map_sprite.c.o(.rodata);
        build/SLUS_006.28/src/map_party.c.o(.rodata);
        build/SLUS_006.28/src/party.c.o(.rodata);
        build/SLUS_006.28/src/map_object.c.o(.rodata);
        build/SLUS_006.28/src/map_animation.c.o(.rodata);
        build/SLUS_006.28/src/map_walk.c.o(.rodata);
        build/SLUS_006.28/src/map_ring.c.o(.rodata);
        build/SLUS_006.28/src/map_think.c.o(.rodata);
        build/SLUS_006.28/src/map_talk.c.o(.rodata);
        build/SLUS_006.28/src/map_load.c.o(.rodata);
        build/SLUS_006.28/src/map_view.c.o(.rodata);
        build/SLUS_006.28/src/map_over.c.o(.rodata);
        build/SLUS_006.28/src/menu_glyph.c.o(.rodata);
        build/SLUS_006.28/asm/data/boot_data.data_80011020_80011054_80011060_800110C4_800127B8_800127FC_80012B70_80012B84_80012BD0_80012BF4_80012C2C_80012C4C_80012C8C.s.o(.data);
        build/SLUS_006.28/src/menu_run.c.o(.rodata);
        build/SLUS_006.28/src/menu_page.c.o(.rodata);
        build/SLUS_006.28/asm/data/boot_data.data_80011020_80011054_80011060_800110C4_800127B8_800127FC_80012B70_80012B84_80012BD0_80012BF4_80012E3C_80012E78.s.o(.data);
        build/SLUS_006.28/src/menu_list.c.o(.rodata);
        build/SLUS_006.28/src/map_look.c.o(.rodata);
        build/SLUS_006.28/src/map_btl.c.o(.rodata);
        build/SLUS_006.28/asm/data/boot_data.data_80011020_80011054_80011060_800110C4_800127B8_800127FC_80012B70_80012B84_80012BD0_80012BF4_80012E3C_80012E78_80012E90_80012EB0.s.o(.data);
        build/SLUS_006.28/src/btl_weapon.c.o(.rodata);
        build/SLUS_006.28/src/btl_boss.c.o(.rodata);
        build/SLUS_006.28/asm/data/boot_data.data_80011020_80011054_80011060_800110C4_800127B8_800127FC_80012B70_80012B84_80012BD0_80012BF4_80012E3C_80012E78_80012F68_80012F80_80012FA4.s.o(.data);
        build/SLUS_006.28/src/libgs_gs_111.c.o(.rodata);
        build/SLUS_006.28/src/libgs_gs_113.c.o(.rodata);
        build/SLUS_006.28/src/libgs_gs_121.c.o(.rodata);
        build/SLUS_006.28/src/libgs_gs_122.c.o(.rodata);
        build/SLUS_006.28/src/libgs_gs_123.c.o(.rodata);
        build/SLUS_006.28/src/libgte_msc00.c.o(.rodata);
        build/SLUS_006.28/asm/data/boot_data.data_80011020_80011054_80011060_800110C4_800127B8_800127FC_80012B70_80012B84_80012BD0_80012BF4_80012E3C_80012E78_80012F68_80012F80_80012FA4_800131C4_80013254.s.o(.data);
        build/SLUS_006.28/src/libcd_bios_1.c.o(.rodata);
        build/SLUS_006.28/asm/data/boot_data.data_80011020_80011054_80011060_800110C4_800127B8_800127FC_80012B70_80012B84_80012BD0_80012BF4_80012E3C_80012E78_80012F68_80012F80_80012FA4_80013474_80013488.s.o(.data);
        build/SLUS_006.28/src/libsnd_sstick.c.o(.rodata);
        build/SLUS_006.28/asm/data/boot_data.data_80011020_80011054_80011060_800110C4_800127B8_800127FC_80012B70_80012B84_80012BD0_80012BF4_80012E3C_80012E78_80012F68_80012F80_80012FA4_80013474_80013488_800138B4_800138D4.s.o(.data);
        build/SLUS_006.28/src/libspu_s_stm.c.o(.rodata);
        build/SLUS_006.28/src/libspu_s_itc.c.o(.rodata);
        build/SLUS_006.28/src/libapi_a11.c.o(.rodata);
        build/SLUS_006.28/src/libspu_s_it.c.o(.rodata);
        build/SLUS_006.28/src/libspu_s_sva.c.o(.rodata);
        build/SLUS_006.28/src/libspu_s_n2p.c.o(.rodata);
        build/SLUS_006.28/src/libspu_s_gvex.c.o(.rodata);
        build/SLUS_006.28/src/libspu_s_scmv.c.o(.rodata);
        build/SLUS_006.28/src/libspu_s_sccv.c.o(.rodata);
        build/SLUS_006.28/src/libspu_s_sccr.c.o(.rodata);
        build/SLUS_006.28/src/libspu_s_sccm.c.o(.rodata);
        build/SLUS_006.28/src/libspu_s_srmt.c.o(.rodata);
        build/SLUS_006.28/src/libspu_s_srmd.c.o(.rodata);
        build/SLUS_006.28/asm/data/boot_data.data_80011020_80011054_80011060_800110C4_800127B8_800127FC_80012B70_80012B84_80012BD0_80012BF4_80012E3C_80012E78_80012F68_80012F80_80012FA4_80013924_80013964.s.o(.data);
        build/SLUS_006.28/src/libmcrd_libmcrd_5.c.o(.rodata);
        build/SLUS_006.28/asm/data/boot_data.data_80011020_80011054_80011060_800110C4_800127B8_800127FC_80012B70_80012B84_80012BD0_80012BF4_80012E3C_80012E78_80012F68_80012F80_80012FA4_80013924_80013964_80013994_80013A60.s.o(.data);
        build/SLUS_006.28/src/libmcrd_libmcrd_9.c.o(.rodata);
        build/SLUS_006.28/asm/data/boot_data.data_80011020_80011054_80011060_800110C4_800127B8_800127FC_80012B70_80012B84_80012BD0_80012BF4_80012E3C_80012E78_80012F68_80012F80_80012FA4_80013924_80013964_80013994_80013A60_80013B2C_80013B8C_80013BE8.s.o(.data);
        build/SLUS_006.28/src/libpad_padentry_2.c.o(.rodata);
        build/SLUS_006.28/asm/data/boot_data.data_80011020_80011054_80011060_800110C4_800127B8_800127FC_80012B70_80012B84_80012BD0_80012BF4_80012E3C_80012E78_80012F68_80012F80_80012FA4_80013924_80013964_80013994_80013A60_80013B2C_80013B8C_80013BE8_80013C24_80013C44.s.o(.data);
        main_TEXT_START = .;
        build/SLUS_006.28/src/2mbyte.c.o(.text);
        build/SLUS_006.28/src/main.c.o(.text);
        build/SLUS_006.28/src/bg_cover.c.o(.text);
        build/SLUS_006.28/src/bg_tile.c.o(.text);
        build/SLUS_006.28/src/packet_shape.c.o(.text);
        build/SLUS_006.28/src/message_draw.c.o(.text);
        build/SLUS_006.28/src/start_picture.c.o(.text);
        build/SLUS_006.28/src/font_cell.c.o(.text);
        build/SLUS_006.28/src/sprite_draw.c.o(.text);
        build/SLUS_006.28/src/btl_draw.c.o(.text);
        build/SLUS_006.28/src/sprite_list.c.o(.text);
        build/SLUS_006.28/src/icon.c.o(.text);
        build/SLUS_006.28/src/exception.c.o(.text);
        build/SLUS_006.28/src/face.c.o(.text);
        build/SLUS_006.28/src/cd_track.c.o(.text);
        build/SLUS_006.28/src/outline.c.o(.text);
        build/SLUS_006.28/src/screen_fade.c.o(.text);
        build/SLUS_006.28/src/layer_grey.c.o(.text);
        build/SLUS_006.28/src/rng.c.o(.text);
        build/SLUS_006.28/src/mth_curv.c.o(.text);
        build/SLUS_006.28/src/tile_layer.c.o(.text);
        build/SLUS_006.28/src/layer_col.c.o(.text);
        build/SLUS_006.28/src/frame.c.o(.text);
        build/SLUS_006.28/src/pad_update.c.o(.text);
        build/SLUS_006.28/src/pad_start.c.o(.text);
        build/SLUS_006.28/src/palette_buf.c.o(.text);
        build/SLUS_006.28/src/resource_load.c.o(.text);
        build/SLUS_006.28/src/tpage.c.o(.text);
        build/SLUS_006.28/src/palette_row.c.o(.text);
        build/SLUS_006.28/src/resource_command.c.o(.text);
        build/SLUS_006.28/src/map_resource.c.o(.text);
        build/SLUS_006.28/src/cdread.c.o(.text);
        build/SLUS_006.28/src/fmt.c.o(.text);
        build/SLUS_006.28/src/inflate.c.o(.text);
        build/SLUS_006.28/src/xmalloc.c.o(.text);
        build/SLUS_006.28/src/overlay.c.o(.text);
        build/SLUS_006.28/src/xa.c.o(.text);
        build/SLUS_006.28/src/sound.c.o(.text);
        build/SLUS_006.28/src/picture.c.o(.text);
        build/SLUS_006.28/src/cd_change.c.o(.text);
        build/SLUS_006.28/src/card.c.o(.text);
        build/SLUS_006.28/src/packet_sprite.c.o(.text);
        build/SLUS_006.28/src/ankprint.c.o(.text);
        build/SLUS_006.28/src/profile.c.o(.text);
        build/SLUS_006.28/src/screen_wait.c.o(.text);
        build/SLUS_006.28/src/mem_move.c.o(.text);
        build/SLUS_006.28/src/palette_animation.c.o(.text);
        build/SLUS_006.28/src/tile_animation.c.o(.text);
        build/SLUS_006.28/src/pad_record.c.o(.text);
        build/SLUS_006.28/src/font_string.c.o(.text);
        build/SLUS_006.28/src/btl_animation.c.o(.text);
        build/SLUS_006.28/src/btl_run.c.o(.text);
        build/SLUS_006.28/src/chr_levelup.c.o(.text);
        build/SLUS_006.28/src/btl_end.c.o(.text);
        build/SLUS_006.28/src/btl_round.c.o(.text);
        build/SLUS_006.28/src/btl_init.c.o(.text);
        build/SLUS_006.28/src/btl_walk.c.o(.text);
        build/SLUS_006.28/src/btl_path.c.o(.text);
        build/SLUS_006.28/src/btl_action.c.o(.text);
        build/SLUS_006.28/src/btl_status.c.o(.text);
        build/SLUS_006.28/src/btl_hit.c.o(.text);
        build/SLUS_006.28/src/btl_attack.c.o(.text);
        build/SLUS_006.28/src/btl_row.c.o(.text);
        build/SLUS_006.28/src/btl_target.c.o(.text);
        build/SLUS_006.28/src/btl_move.c.o(.text);
        build/SLUS_006.28/src/btl_slot.c.o(.text);
        build/SLUS_006.28/src/btl_fall.c.o(.text);
        build/SLUS_006.28/src/btl_frame.c.o(.text);
        build/SLUS_006.28/src/btl_pick.c.o(.text);
        build/SLUS_006.28/src/btl_acting.c.o(.text);
        build/SLUS_006.28/src/btl_enemy.c.o(.text);
        build/SLUS_006.28/src/btl_outcome.c.o(.text);
        build/SLUS_006.28/src/btl_plan.c.o(.text);
        build/SLUS_006.28/src/start_screen.c.o(.text);
        build/SLUS_006.28/src/btl_menu.c.o(.text);
        build/SLUS_006.28/src/btl_command.c.o(.text);
        build/SLUS_006.28/src/btl_window.c.o(.text);
        build/SLUS_006.28/src/btl_amount.c.o(.text);
        build/SLUS_006.28/src/btl_panel.c.o(.text);
        build/SLUS_006.28/src/btl_message.c.o(.text);
        build/SLUS_006.28/src/btl_choice.c.o(.text);
        build/SLUS_006.28/src/shop_run.c.o(.text);
        build/SLUS_006.28/src/shop_screen.c.o(.text);
        build/SLUS_006.28/src/shop_strings.c.o(.text);
        build/SLUS_006.28/src/mem_request.c.o(.text);
        build/SLUS_006.28/src/shop_face.c.o(.text);
        build/SLUS_006.28/src/layer_mix.c.o(.text);
        build/SLUS_006.28/src/music_play.c.o(.text);
        build/SLUS_006.28/src/music_bank.c.o(.text);
        build/SLUS_006.28/src/music_voice.c.o(.text);
        build/SLUS_006.28/src/map_frame.c.o(.text);
        build/SLUS_006.28/src/game_start.c.o(.text);
        build/SLUS_006.28/src/map_step.c.o(.text);
        build/SLUS_006.28/src/chr_level.c.o(.text);
        build/SLUS_006.28/src/map_endcopy.c.o(.text);
        build/SLUS_006.28/src/map_fade.c.o(.text);
        build/SLUS_006.28/src/cell_text.c.o(.text);
        build/SLUS_006.28/src/cell_face.c.o(.text);
        build/SLUS_006.28/src/story.c.o(.text);
        build/SLUS_006.28/src/chr_item.c.o(.text);
        build/SLUS_006.28/src/chr_worn.c.o(.text);
        build/SLUS_006.28/src/map_music.c.o(.text);
        build/SLUS_006.28/src/movie.c.o(.text);
        build/SLUS_006.28/src/map_attribute.c.o(.text);
        build/SLUS_006.28/src/map_change.c.o(.text);
        build/SLUS_006.28/src/script_run.c.o(.text);
        build/SLUS_006.28/src/message_disp.c.o(.text);
        build/SLUS_006.28/src/lns_intp.c.o(.text);
        build/SLUS_006.28/src/lns_move.c.o(.text);
        build/SLUS_006.28/src/script_move.c.o(.text);
        build/SLUS_006.28/src/move_command.c.o(.text);
        build/SLUS_006.28/src/step_command.c.o(.text);
        build/SLUS_006.28/src/map_sprite.c.o(.text);
        build/SLUS_006.28/src/map_party.c.o(.text);
        build/SLUS_006.28/src/party.c.o(.text);
        build/SLUS_006.28/src/map_object.c.o(.text);
        build/SLUS_006.28/src/map_animation.c.o(.text);
        build/SLUS_006.28/src/map_walk.c.o(.text);
        build/SLUS_006.28/src/map_ring.c.o(.text);
        build/SLUS_006.28/src/map_think.c.o(.text);
        build/SLUS_006.28/src/map_talk.c.o(.text);
        build/SLUS_006.28/src/map_load.c.o(.text);
        build/SLUS_006.28/src/map_view.c.o(.text);
        build/SLUS_006.28/src/map_over.c.o(.text);
        build/SLUS_006.28/src/menu_glyph.c.o(.text);
        build/SLUS_006.28/src/menu_run.c.o(.text);
        build/SLUS_006.28/src/menu_page.c.o(.text);
        build/SLUS_006.28/src/menu_places.c.o(.text);
        build/SLUS_006.28/src/menu_card.c.o(.text);
        build/SLUS_006.28/src/menu_option.c.o(.text);
        build/SLUS_006.28/src/menu_nowalk.c.o(.text);
        build/SLUS_006.28/src/face_list.c.o(.text);
        build/SLUS_006.28/src/menu_use.c.o(.text);
        build/SLUS_006.28/src/menu_list.c.o(.text);
        build/SLUS_006.28/src/map_look.c.o(.text);
        build/SLUS_006.28/src/map_btl.c.o(.text);
        build/SLUS_006.28/src/map_touch.c.o(.text);
        build/SLUS_006.28/src/btl_show.c.o(.text);
        build/SLUS_006.28/src/btl_item.c.o(.text);
        build/SLUS_006.28/src/btl_weapon.c.o(.text);
        build/SLUS_006.28/src/btl_boss.c.o(.text);
        build/SLUS_006.28/src/btl_show_frame.c.o(.text);
        build/SLUS_006.28/src/btl_effect.c.o(.text);
        build/SLUS_006.28/src/libapi_c57.c.o(.text);
        build/SLUS_006.28/src/libapi_c68.c.o(.text);
        build/SLUS_006.28/src/libapi_c112.c.o(.text);
        build/SLUS_006.28/src/libapi_a36.c.o(.text);
        build/SLUS_006.28/src/libapi_a37.c.o(.text);
        build/SLUS_006.28/src/libapi_a50.c.o(.text);
        build/SLUS_006.28/src/libapi_a51.c.o(.text);
        build/SLUS_006.28/src/libapi_a52.c.o(.text);
        build/SLUS_006.28/src/libapi_a53.c.o(.text);
        build/SLUS_006.28/src/libapi_a54.c.o(.text);
        build/SLUS_006.28/src/libapi_a81.c.o(.text);
        build/SLUS_006.28/src/libapi_i_heap2.c.o(.text);
        build/SLUS_006.28/src/libapi_malloc2.c.o(.text);
        build/SLUS_006.28/src/libapi_free2.c.o(.text);
        build/SLUS_006.28/src/libc2_bcopy.c.o(.text);
        build/SLUS_006.28/src/libc2_bzero.c.o(.text);
        build/SLUS_006.28/src/libc2_memset.c.o(.text);
        build/SLUS_006.28/src/libc2_strcmp.c.o(.text);
        build/SLUS_006.28/src/libc2_strcpy.c.o(.text);
        build/SLUS_006.28/src/libc2_strlen.c.o(.text);
        build/SLUS_006.28/src/libgpu_sys_1.c.o(.text);
        build/SLUS_006.28/src/libgpu_sys_2.c.o(.text);
        build/SLUS_006.28/src/libgpu_sys_3.c.o(.text);
        build/SLUS_006.28/src/libgpu_sys_4.c.o(.text);
        build/SLUS_006.28/src/libgpu_sys_5.c.o(.text);
        build/SLUS_006.28/src/libgpu_sys_6.c.o(.text);
        build/SLUS_006.28/src/libapi_c73.c.o(.text);
        build/SLUS_006.28/src/libc2_memcpy.c.o(.text);
        build/SLUS_006.28/src/libgpu_e01.c.o(.text);
        build/SLUS_006.28/src/libgpu_e03.c.o(.text);
        build/SLUS_006.28/src/libgpu_e04.c.o(.text);
        build/SLUS_006.28/src/libgpu_p00.c.o(.text);
        build/SLUS_006.28/src/libgpu_p01.c.o(.text);
        build/SLUS_006.28/src/libgpu_p06.c.o(.text);
        build/SLUS_006.28/src/libgpu_p10.c.o(.text);
        build/SLUS_006.28/src/libgpu_p12.c.o(.text);
        build/SLUS_006.28/src/libgpu_p16.c.o(.text);
        build/SLUS_006.28/src/libgpu_p26.c.o(.text);
        build/SLUS_006.28/src/libgpu_p29.c.o(.text);
        build/SLUS_006.28/src/libgpu_p33.c.o(.text);
        build/SLUS_006.28/src/libgs_gs_001_1.c.o(.text);
        build/SLUS_006.28/src/libgs_gs_001_2.c.o(.text);
        build/SLUS_006.28/src/libgs_gs_001_3.c.o(.text);
        build/SLUS_006.28/src/libgs_gs_002.c.o(.text);
        build/SLUS_006.28/src/libgs_gs_003.c.o(.text);
        build/SLUS_006.28/src/libgs_gs_006.c.o(.text);
        build/SLUS_006.28/src/libgs_gs_007.c.o(.text);
        build/SLUS_006.28/src/libapi_counter_1.c.o(.text);
        build/SLUS_006.28/src/libapi_counter_2.c.o(.text);
        build/SLUS_006.28/src/libgs_gs_008.c.o(.text);
        build/SLUS_006.28/src/libgs_gs_010.c.o(.text);
        build/SLUS_006.28/src/libgs_gs_103.c.o(.text);
        build/SLUS_006.28/src/libgs_gs_104.c.o(.text);
        build/SLUS_006.28/src/libgs_gs_107_1.c.o(.text);
        build/SLUS_006.28/src/libgs_gs_107_2.c.o(.text);
        build/SLUS_006.28/src/libgs_gs_107_3.c.o(.text);
        build/SLUS_006.28/src/libgs_gs_111.c.o(.text);
        build/SLUS_006.28/src/libgs_gs_113.c.o(.text);
        build/SLUS_006.28/src/libgs_gs_121.c.o(.text);
        build/SLUS_006.28/src/libgs_gs_122.c.o(.text);
        build/SLUS_006.28/src/libgs_gs_123.c.o(.text);
        build/SLUS_006.28/src/libgte_msc00.c.o(.text);
        build/SLUS_006.28/src/libgte_msc01.c.o(.text);
        build/SLUS_006.28/src/libgte_mtx_11.c.o(.text);
        build/SLUS_006.28/src/libgte_reg11.c.o(.text);
        build/SLUS_006.28/src/libgte_reg12.c.o(.text);
        build/SLUS_006.28/src/libgte_patchgte.c.o(.text);
        build/SLUS_006.28/src/libcd_cdrom.c.o(.text);
        build/SLUS_006.28/src/libcd_toc_1.c.o(.text);
        build/SLUS_006.28/src/libcd_toc_2.c.o(.text);
        build/SLUS_006.28/src/libcd_event_1.c.o(.text);
        build/SLUS_006.28/src/libcd_event_2.c.o(.text);
        build/SLUS_006.28/src/libapi_a07.c.o(.text);
        build/SLUS_006.28/src/libcd_sys_1.c.o(.text);
        build/SLUS_006.28/src/libcd_sys_2.c.o(.text);
        build/SLUS_006.28/src/libcd_sys_3.c.o(.text);
        build/SLUS_006.28/src/libcd_sys_4.c.o(.text);
        build/SLUS_006.28/src/libcd_sys_5.c.o(.text);
        build/SLUS_006.28/src/libcd_sys_6.c.o(.text);
        build/SLUS_006.28/src/libcd_sys_7.c.o(.text);
        build/SLUS_006.28/src/libcd_bios_1.c.o(.text);
        build/SLUS_006.28/src/libcd_bios_2.c.o(.text);
        build/SLUS_006.28/src/libcd_bios_3.c.o(.text);
        build/SLUS_006.28/src/libc2_puts.c.o(.text);
        build/SLUS_006.28/src/libc2_putchar.c.o(.text);
        build/SLUS_006.28/src/libc2_ctype.c.o(.text);
        build/SLUS_006.28/src/libcd_iso9660.c.o(.text);
        build/SLUS_006.28/src/libc2_strncmp.c.o(.text);
        build/SLUS_006.28/src/libcd_cdread_1.c.o(.text);
        build/SLUS_006.28/src/libcd_cdread_2.c.o(.text);
        build/SLUS_006.28/src/libcd_cdread2_1.c.o(.text);
        build/SLUS_006.28/src/libcd_cdread2_2.c.o(.text);
        build/SLUS_006.28/src/libcd_c_002.c.o(.text);
        build/SLUS_006.28/src/libcd_c_004_1.c.o(.text);
        build/SLUS_006.28/src/libcd_c_004_2.c.o(.text);
        build/SLUS_006.28/src/libcd_c_005.c.o(.text);
        build/SLUS_006.28/src/libcd_c_007.c.o(.text);
        build/SLUS_006.28/src/libcd_c_008.c.o(.text);
        build/SLUS_006.28/src/libcd_c_009.c.o(.text);
        build/SLUS_006.28/src/libcd_c_010.c.o(.text);
        build/SLUS_006.28/src/libcd_c_011_1.c.o(.text);
        build/SLUS_006.28/src/libcd_c_011_2.c.o(.text);
        build/SLUS_006.28/src/libcd_s_002.c.o(.text);
        build/SLUS_006.28/src/libetc_vsync_1.c.o(.text);
        build/SLUS_006.28/src/libetc_vsync_2.c.o(.text);
        build/SLUS_006.28/src/libapi_a91.c.o(.text);
        build/SLUS_006.28/src/libapi_l10.c.o(.text);
        build/SLUS_006.28/src/libetc_intr_1.c.o(.text);
        build/SLUS_006.28/src/libetc_intr_2.c.o(.text);
        build/SLUS_006.28/src/libapi_c114.c.o(.text);
        build/SLUS_006.28/src/libapi_a23.c.o(.text);
        build/SLUS_006.28/src/libapi_a24.c.o(.text);
        build/SLUS_006.28/src/libapi_a25.c.o(.text);
        build/SLUS_006.28/src/libc2_setjmp.c.o(.text);
        build/SLUS_006.28/src/libetc_intr_vb_1.c.o(.text);
        build/SLUS_006.28/src/libetc_intr_vb_2.c.o(.text);
        build/SLUS_006.28/src/libetc_intr_dma_1.c.o(.text);
        build/SLUS_006.28/src/libetc_intr_dma_2.c.o(.text);
        build/SLUS_006.28/src/libetc_vmode.c.o(.text);
        build/SLUS_006.28/src/libsnd_ssclose_1.c.o(.text);
        build/SLUS_006.28/src/libsnd_ssclose_2.c.o(.text);
        build/SLUS_006.28/src/libsnd_ssend.c.o(.text);
        build/SLUS_006.28/src/libsnd_ssinit.c.o(.text);
        build/SLUS_006.28/src/libsnd_ssinit_c.c.o(.text);
        build/SLUS_006.28/src/libsnd_ssloop.c.o(.text);
        build/SLUS_006.28/src/libsnd_ssopenq.c.o(.text);
        build/SLUS_006.28/src/libsnd_cc_0.c.o(.text);
        build/SLUS_006.28/src/libsnd_cc_6.c.o(.text);
        build/SLUS_006.28/src/libsnd_cc_7.c.o(.text);
        build/SLUS_006.28/src/libsnd_cc_10.c.o(.text);
        build/SLUS_006.28/src/libsnd_cc_11.c.o(.text);
        build/SLUS_006.28/src/libsnd_cc_64.c.o(.text);
        build/SLUS_006.28/src/libsnd_cc_91.c.o(.text);
        build/SLUS_006.28/src/libsnd_cc_98.c.o(.text);
        build/SLUS_006.28/src/libsnd_cc_99.c.o(.text);
        build/SLUS_006.28/src/libsnd_cc_100.c.o(.text);
        build/SLUS_006.28/src/libsnd_cc_101.c.o(.text);
        build/SLUS_006.28/src/libsnd_cc_121.c.o(.text);
        build/SLUS_006.28/src/libsnd_de_0.c.o(.text);
        build/SLUS_006.28/src/libsnd_de_1.c.o(.text);
        build/SLUS_006.28/src/libsnd_de_2.c.o(.text);
        build/SLUS_006.28/src/libsnd_de_3.c.o(.text);
        build/SLUS_006.28/src/libsnd_de_4.c.o(.text);
        build/SLUS_006.28/src/libsnd_ccadsr.c.o(.text);
        build/SLUS_006.28/src/libsnd_de_5.c.o(.text);
        build/SLUS_006.28/src/libsnd_de_6.c.o(.text);
        build/SLUS_006.28/src/libsnd_de_7.c.o(.text);
        build/SLUS_006.28/src/libsnd_de_8.c.o(.text);
        build/SLUS_006.28/src/libsnd_de_9.c.o(.text);
        build/SLUS_006.28/src/libsnd_de_10.c.o(.text);
        build/SLUS_006.28/src/libsnd_de_11.c.o(.text);
        build/SLUS_006.28/src/libsnd_de_12.c.o(.text);
        build/SLUS_006.28/src/libsnd_de_13.c.o(.text);
        build/SLUS_006.28/src/libsnd_de_14.c.o(.text);
        build/SLUS_006.28/src/libsnd_de_15.c.o(.text);
        build/SLUS_006.28/src/libsnd_de_16.c.o(.text);
        build/SLUS_006.28/src/libsnd_de_17.c.o(.text);
        build/SLUS_006.28/src/libsnd_de_18.c.o(.text);
        build/SLUS_006.28/src/libsnd_de_19.c.o(.text);
        build/SLUS_006.28/src/libsnd_midibend.c.o(.text);
        build/SLUS_006.28/src/libsnd_midicc.c.o(.text);
        build/SLUS_006.28/src/libsnd_midimeta.c.o(.text);
        build/SLUS_006.28/src/libsnd_midinote.c.o(.text);
        build/SLUS_006.28/src/libsnd_midiprog.c.o(.text);
        build/SLUS_006.28/src/libsnd_miditime.c.o(.text);
        build/SLUS_006.28/src/libsnd_seqinit.c.o(.text);
        build/SLUS_006.28/src/libsnd_ssplay.c.o(.text);
        build/SLUS_006.28/src/libsnd_playmode.c.o(.text);
        build/SLUS_006.28/src/libsnd_ssstart_1.c.o(.text);
        build/SLUS_006.28/src/libsnd_ssstart_2.c.o(.text);
        build/SLUS_006.28/src/libsnd_ssstart_3.c.o(.text);
        build/SLUS_006.28/src/libsnd_ssstart_4.c.o(.text);
        build/SLUS_006.28/src/libsnd_sscall.c.o(.text);
        build/SLUS_006.28/src/libsnd_cres.c.o(.text);
        build/SLUS_006.28/src/libsnd_pause.c.o(.text);
        build/SLUS_006.28/src/libsnd_play.c.o(.text);
        build/SLUS_006.28/src/libsnd_midiread.c.o(.text);
        build/SLUS_006.28/src/libsnd_next.c.o(.text);
        build/SLUS_006.28/src/libsnd_replay.c.o(.text);
        build/SLUS_006.28/src/libsnd_ssstop_1.c.o(.text);
        build/SLUS_006.28/src/libsnd_ssstop_2.c.o(.text);
        build/SLUS_006.28/src/libsnd_sstable.c.o(.text);
        build/SLUS_006.28/src/libsnd_sstick.c.o(.text);
        build/SLUS_006.28/src/libsnd_ssvol.c.o(.text);
        build/SLUS_006.28/src/libsnd_tempo.c.o(.text);
        build/SLUS_006.28/src/libsnd_ut_gpa.c.o(.text);
        build/SLUS_006.28/src/libsnd_ut_gva.c.o(.text);
        build/SLUS_006.28/src/libsnd_ut_rdel.c.o(.text);
        build/SLUS_006.28/src/libsnd_ut_rdep.c.o(.text);
        build/SLUS_006.28/src/libsnd_ut_rev.c.o(.text);
        build/SLUS_006.28/src/libsnd_ut_rfb.c.o(.text);
        build/SLUS_006.28/src/libsnd_ut_roff.c.o(.text);
        build/SLUS_006.28/src/libsnd_ut_ron.c.o(.text);
        build/SLUS_006.28/src/libsnd_ut_sva.c.o(.text);
        build/SLUS_006.28/src/libsnd_vm_doff.c.o(.text);
        build/SLUS_006.28/src/libsnd_vm_don.c.o(.text);
        build/SLUS_006.28/src/libsnd_vm_f.c.o(.text);
        build/SLUS_006.28/src/libsnd_vm_init.c.o(.text);
        build/SLUS_006.28/src/libsnd_vm_key_1.c.o(.text);
        build/SLUS_006.28/src/libsnd_vm_key_2.c.o(.text);
        build/SLUS_006.28/src/libsnd_vm_aloc1.c.o(.text);
        build/SLUS_006.28/src/libsnd_vm_aloc2.c.o(.text);
        build/SLUS_006.28/src/libsnd_vm_n2p.c.o(.text);
        build/SLUS_006.28/src/libsnd_vm_no1.c.o(.text);
        build/SLUS_006.28/src/libsnd_vm_noff.c.o(.text);
        build/SLUS_006.28/src/libsnd_vm_nowof.c.o(.text);
        build/SLUS_006.28/src/libsnd_vm_nowon.c.o(.text);
        build/SLUS_006.28/src/libsnd_vm_pb.c.o(.text);
        build/SLUS_006.28/src/libsnd_vm_prog.c.o(.text);
        build/SLUS_006.28/src/libsnd_vm_seq.c.o(.text);
        build/SLUS_006.28/src/libsnd_vm_stav.c.o(.text);
        build/SLUS_006.28/src/libsnd_vm_vol.c.o(.text);
        build/SLUS_006.28/src/libsnd_vm_vsu.c.o(.text);
        build/SLUS_006.28/src/libsnd_vs_mono.c.o(.text);
        build/SLUS_006.28/src/libsnd_vs_vab.c.o(.text);
        build/SLUS_006.28/src/libsnd_vs_vh2.c.o(.text);
        build/SLUS_006.28/src/libsnd_vs_vh.c.o(.text);
        build/SLUS_006.28/src/libsnd_vs_vtb.c.o(.text);
        build/SLUS_006.28/src/libsnd_vs_vtc.c.o(.text);
        build/SLUS_006.28/src/libspu_s_i.c.o(.text);
        build/SLUS_006.28/src/libspu_s_ini_1.c.o(.text);
        build/SLUS_006.28/src/libspu_s_ini_2.c.o(.text);
        build/SLUS_006.28/src/libapi_a08.c.o(.text);
        build/SLUS_006.28/src/libapi_a12.c.o(.text);
        build/SLUS_006.28/src/libspu_spu_1.c.o(.text);
        build/SLUS_006.28/src/libspu_spu_2.c.o(.text);
        build/SLUS_006.28/src/libspu_spu_3.c.o(.text);
        build/SLUS_006.28/src/libspu_s_dcb.c.o(.text);
        build/SLUS_006.28/src/libspu_s_m_init.c.o(.text);
        build/SLUS_006.28/src/libspu_s_m_m.c.o(.text);
        build/SLUS_006.28/src/libspu_s_m_int.c.o(.text);
        build/SLUS_006.28/src/libspu_s_m_f.c.o(.text);
        build/SLUS_006.28/src/libspu_s_snv.c.o(.text);
        build/SLUS_006.28/src/libspu_s_sav.c.o(.text);
        build/SLUS_006.28/src/libspu_s_gnv.c.o(.text);
        build/SLUS_006.28/src/libspu_s_gav.c.o(.text);
        build/SLUS_006.28/src/libspu_s_snc.c.o(.text);
        build/SLUS_006.28/src/libspu_s_sr.c.o(.text);
        build/SLUS_006.28/src/libspu_s_m_util.c.o(.text);
        build/SLUS_006.28/src/libspu_s_srmp.c.o(.text);
        build/SLUS_006.28/src/libspu_s_sra.c.o(.text);
        build/SLUS_006.28/src/libspu_s_srv.c.o(.text);
        build/SLUS_006.28/src/libspu_s_grv.c.o(.text);
        build/SLUS_006.28/src/libspu_s_crwa.c.o(.text);
        build/SLUS_006.28/src/libapi_a10.c.o(.text);
        build/SLUS_006.28/src/libspu_s_sk.c.o(.text);
        build/SLUS_006.28/src/libspu_s_r.c.o(.text);
        build/SLUS_006.28/src/libspu_s_stsa.c.o(.text);
        build/SLUS_006.28/src/libspu_s_stm.c.o(.text);
        build/SLUS_006.28/src/libspu_s_itc.c.o(.text);
        build/SLUS_006.28/src/libapi_a11.c.o(.text);
        build/SLUS_006.28/src/libspu_s_it.c.o(.text);
        build/SLUS_006.28/src/libspu_s_sva.c.o(.text);
        build/SLUS_006.28/src/libspu_s_n2p.c.o(.text);
        build/SLUS_006.28/src/libspu_s_gvex.c.o(.text);
        build/SLUS_006.28/src/libspu_s_scmv.c.o(.text);
        build/SLUS_006.28/src/libspu_s_sccv.c.o(.text);
        build/SLUS_006.28/src/libspu_s_sccr.c.o(.text);
        build/SLUS_006.28/src/libspu_s_sccm.c.o(.text);
        build/SLUS_006.28/src/libspu_s_srmt.c.o(.text);
        build/SLUS_006.28/src/libspu_s_srmd.c.o(.text);
        build/SLUS_006.28/src/libmcrd_init.c.o(.text);
        build/SLUS_006.28/src/libcard_init.c.o(.text);
        build/SLUS_006.28/src/libapi_pad_1.c.o(.text);
        build/SLUS_006.28/src/libapi_pad_2.c.o(.text);
        build/SLUS_006.28/src/libapi_pad_3.c.o(.text);
        build/SLUS_006.28/src/libapi_pad_4.c.o(.text);
        build/SLUS_006.28/src/libapi_a18.c.o(.text);
        build/SLUS_006.28/src/libapi_a19.c.o(.text);
        build/SLUS_006.28/src/libapi_a20.c.o(.text);
        build/SLUS_006.28/src/libapi_a21.c.o(.text);
        build/SLUS_006.28/src/libapi_l02.c.o(.text);
        build/SLUS_006.28/src/libapi_l03.c.o(.text);
        build/SLUS_006.28/src/libapi_patch.c.o(.text);
        build/SLUS_006.28/src/libapi_chclrpad.c.o(.text);
        build/SLUS_006.28/src/libcard_a74.c.o(.text);
        build/SLUS_006.28/src/libcard_a75.c.o(.text);
        build/SLUS_006.28/src/libcard_a76.c.o(.text);
        build/SLUS_006.28/src/libcard_patch.c.o(.text);
        build/SLUS_006.28/src/libcard_end.c.o(.text);
        build/SLUS_006.28/src/libmcrd_libmcrd_1.c.o(.text);
        build/SLUS_006.28/src/libmcrd_libmcrd_2.c.o(.text);
        build/SLUS_006.28/src/libmcrd_libmcrd_3.c.o(.text);
        build/SLUS_006.28/src/libmcrd_libmcrd_4.c.o(.text);
        build/SLUS_006.28/src/libmcrd_libmcrd_5.c.o(.text);
        build/SLUS_006.28/src/libmcrd_libmcrd_6.c.o(.text);
        build/SLUS_006.28/src/libmcrd_libmcrd_7.c.o(.text);
        build/SLUS_006.28/src/libmcrd_libmcrd_8.c.o(.text);
        build/SLUS_006.28/src/libmcrd_libmcrd_9.c.o(.text);
        build/SLUS_006.28/src/libmcrd_libmcrd_10.c.o(.text);
        build/SLUS_006.28/src/libmcrd_libmcrd_11.c.o(.text);
        build/SLUS_006.28/src/libmcrd_libmcrd_12.c.o(.text);
        build/SLUS_006.28/src/libmcrd_libmcrd_13.c.o(.text);
        build/SLUS_006.28/src/libapi_a67.c.o(.text);
        build/SLUS_006.28/src/libapi_a69.c.o(.text);
        build/SLUS_006.28/src/libapi_first.c.o(.text);
        build/SLUS_006.28/src/libapi_a66.c.o(.text);
        build/SLUS_006.28/src/libc2_strcat.c.o(.text);
        build/SLUS_006.28/src/libcard_c171.c.o(.text);
        build/SLUS_006.28/src/libcard_c172.c.o(.text);
        build/SLUS_006.28/src/libcard_a78.c.o(.text);
        build/SLUS_006.28/src/libcard_a80.c.o(.text);
        build/SLUS_006.28/src/libcard_card.c.o(.text);
        build/SLUS_006.28/src/libmcrd_userfunc_1.c.o(.text);
        build/SLUS_006.28/src/libmcrd_userfunc_2.c.o(.text);
        build/SLUS_006.28/src/libmcrd_userfunc_3.c.o(.text);
        build/SLUS_006.28/src/libmcrd_bios_1.c.o(.text);
        build/SLUS_006.28/src/libmcrd_bios_2.c.o(.text);
        build/SLUS_006.28/src/libmcrd_bios_3.c.o(.text);
        build/SLUS_006.28/src/libmcrd_bios_4.c.o(.text);
        build/SLUS_006.28/src/libmcrd_bios_5.c.o(.text);
        build/SLUS_006.28/src/libmcrd_bios_6.c.o(.text);
        build/SLUS_006.28/src/libmcrd_bios_7.c.o(.text);
        build/SLUS_006.28/src/libapi_a09.c.o(.text);
        build/SLUS_006.28/src/libmcrd_low.c.o(.text);
        build/SLUS_006.28/src/libc2_strncpy.c.o(.text);
        build/SLUS_006.28/src/libcard_a79.c.o(.text);
        build/SLUS_006.28/src/libpad_padentry_1.c.o(.text);
        build/SLUS_006.28/src/libpad_padentry_2.c.o(.text);
        build/SLUS_006.28/src/libpad_padmain.c.o(.text);
        build/SLUS_006.28/src/libpad_padcmd.c.o(.text);
        build/SLUS_006.28/src/libpad_padif.c.o(.text);
        build/SLUS_006.28/src/libpad_padportd.c.o(.text);
        build/SLUS_006.28/src/libpad_padseqd.c.o(.text);
        build/SLUS_006.28/src/libpad_waitrc2.c.o(.text);
        . = ALIGN(., 4);
        main_TEXT_END = .;
        main_TEXT_SIZE = ABSOLUTE(main_TEXT_END - main_TEXT_START);
        main_DATA_START = .;
        build/SLUS_006.28/src/2mbyte.c.o(.data);
        build/SLUS_006.28/src/main.c.o(.data);
        build/SLUS_006.28/src/bg_cover.c.o(.data);
        build/SLUS_006.28/src/bg_tile.c.o(.data);
        build/SLUS_006.28/src/packet_shape.c.o(.data);
        build/SLUS_006.28/src/message_draw.c.o(.data);
        build/SLUS_006.28/src/start_picture.c.o(.data);
        build/SLUS_006.28/src/font_cell.c.o(.data);
        build/SLUS_006.28/src/sprite_draw.c.o(.data);
        build/SLUS_006.28/src/btl_draw.c.o(.data);
        build/SLUS_006.28/src/sprite_list.c.o(.data);
        build/SLUS_006.28/src/icon.c.o(.data);
        build/SLUS_006.28/src/exception.c.o(.data);
        build/SLUS_006.28/src/face.c.o(.data);
        build/SLUS_006.28/src/cd_track.c.o(.data);
        build/SLUS_006.28/src/outline.c.o(.data);
        build/SLUS_006.28/src/screen_fade.c.o(.data);
        build/SLUS_006.28/src/layer_grey.c.o(.data);
        build/SLUS_006.28/src/rng.c.o(.data);
        build/SLUS_006.28/src/mth_curv.c.o(.data);
        build/SLUS_006.28/src/tile_layer.c.o(.data);
        build/SLUS_006.28/src/layer_col.c.o(.data);
        build/SLUS_006.28/src/frame.c.o(.data);
        build/SLUS_006.28/src/pad_update.c.o(.data);
        build/SLUS_006.28/src/pad_start.c.o(.data);
        build/SLUS_006.28/src/palette_buf.c.o(.data);
        build/SLUS_006.28/src/resource_load.c.o(.data);
        build/SLUS_006.28/src/tpage.c.o(.data);
        build/SLUS_006.28/src/palette_row.c.o(.data);
        build/SLUS_006.28/src/resource_command.c.o(.data);
        build/SLUS_006.28/src/map_resource.c.o(.data);
        build/SLUS_006.28/src/cdread.c.o(.data);
        build/SLUS_006.28/src/fmt.c.o(.data);
        build/SLUS_006.28/src/inflate.c.o(.data);
        build/SLUS_006.28/src/xmalloc.c.o(.data);
        build/SLUS_006.28/src/overlay.c.o(.data);
        build/SLUS_006.28/src/xa.c.o(.data);
        build/SLUS_006.28/src/sound.c.o(.data);
        build/SLUS_006.28/src/picture.c.o(.data);
        build/SLUS_006.28/src/cd_change.c.o(.data);
        build/SLUS_006.28/src/card.c.o(.data);
        build/SLUS_006.28/src/packet_sprite.c.o(.data);
        build/SLUS_006.28/src/ankprint.c.o(.data);
        build/SLUS_006.28/src/profile.c.o(.data);
        build/SLUS_006.28/src/screen_wait.c.o(.data);
        build/SLUS_006.28/src/mem_move.c.o(.data);
        build/SLUS_006.28/src/palette_animation.c.o(.data);
        build/SLUS_006.28/src/tile_animation.c.o(.data);
        build/SLUS_006.28/src/pad_record.c.o(.data);
        build/SLUS_006.28/src/font_string.c.o(.data);
        build/SLUS_006.28/src/btl_animation.c.o(.data);
        build/SLUS_006.28/src/btl_run.c.o(.data);
        build/SLUS_006.28/src/chr_levelup.c.o(.data);
        build/SLUS_006.28/src/btl_end.c.o(.data);
        build/SLUS_006.28/src/btl_round.c.o(.data);
        build/SLUS_006.28/src/btl_init.c.o(.data);
        build/SLUS_006.28/src/btl_walk.c.o(.data);
        build/SLUS_006.28/src/btl_path.c.o(.data);
        build/SLUS_006.28/src/btl_action.c.o(.data);
        build/SLUS_006.28/src/btl_status.c.o(.data);
        build/SLUS_006.28/src/btl_hit.c.o(.data);
        build/SLUS_006.28/src/btl_attack.c.o(.data);
        build/SLUS_006.28/src/btl_row.c.o(.data);
        build/SLUS_006.28/src/btl_target.c.o(.data);
        build/SLUS_006.28/src/btl_move.c.o(.data);
        build/SLUS_006.28/src/btl_slot.c.o(.data);
        build/SLUS_006.28/src/btl_fall.c.o(.data);
        build/SLUS_006.28/src/btl_frame.c.o(.data);
        build/SLUS_006.28/src/btl_pick.c.o(.data);
        build/SLUS_006.28/src/btl_acting.c.o(.data);
        build/SLUS_006.28/src/btl_enemy.c.o(.data);
        build/SLUS_006.28/src/btl_outcome.c.o(.data);
        build/SLUS_006.28/src/btl_plan.c.o(.data);
        build/SLUS_006.28/src/start_screen.c.o(.data);
        build/SLUS_006.28/src/btl_menu.c.o(.data);
        build/SLUS_006.28/src/btl_command.c.o(.data);
        build/SLUS_006.28/src/btl_window.c.o(.data);
        build/SLUS_006.28/src/btl_amount.c.o(.data);
        build/SLUS_006.28/src/btl_panel.c.o(.data);
        build/SLUS_006.28/src/btl_message.c.o(.data);
        build/SLUS_006.28/src/btl_choice.c.o(.data);
        build/SLUS_006.28/src/shop_run.c.o(.data);
        build/SLUS_006.28/src/shop_screen.c.o(.data);
        build/SLUS_006.28/src/shop_strings.c.o(.data);
        build/SLUS_006.28/src/mem_request.c.o(.data);
        build/SLUS_006.28/src/shop_face.c.o(.data);
        build/SLUS_006.28/src/layer_mix.c.o(.data);
        build/SLUS_006.28/src/music_play.c.o(.data);
        build/SLUS_006.28/src/music_bank.c.o(.data);
        build/SLUS_006.28/src/music_voice.c.o(.data);
        build/SLUS_006.28/src/map_frame.c.o(.data);
        build/SLUS_006.28/src/game_start.c.o(.data);
        build/SLUS_006.28/src/map_step.c.o(.data);
        build/SLUS_006.28/src/chr_level.c.o(.data);
        build/SLUS_006.28/src/map_endcopy.c.o(.data);
        build/SLUS_006.28/src/map_fade.c.o(.data);
        build/SLUS_006.28/src/cell_text.c.o(.data);
        build/SLUS_006.28/src/cell_face.c.o(.data);
        build/SLUS_006.28/src/story.c.o(.data);
        build/SLUS_006.28/src/chr_item.c.o(.data);
        build/SLUS_006.28/src/chr_worn.c.o(.data);
        build/SLUS_006.28/src/map_music.c.o(.data);
        build/SLUS_006.28/src/movie.c.o(.data);
        build/SLUS_006.28/src/map_attribute.c.o(.data);
        build/SLUS_006.28/src/map_change.c.o(.data);
        build/SLUS_006.28/src/script_run.c.o(.data);
        build/SLUS_006.28/src/message_disp.c.o(.data);
        build/SLUS_006.28/src/lns_intp.c.o(.data);
        build/SLUS_006.28/src/lns_move.c.o(.data);
        build/SLUS_006.28/src/script_move.c.o(.data);
        build/SLUS_006.28/src/move_command.c.o(.data);
        build/SLUS_006.28/src/step_command.c.o(.data);
        build/SLUS_006.28/src/map_sprite.c.o(.data);
        build/SLUS_006.28/src/map_party.c.o(.data);
        build/SLUS_006.28/src/party.c.o(.data);
        build/SLUS_006.28/src/map_object.c.o(.data);
        build/SLUS_006.28/src/map_animation.c.o(.data);
        build/SLUS_006.28/src/map_walk.c.o(.data);
        build/SLUS_006.28/src/map_ring.c.o(.data);
        build/SLUS_006.28/src/map_think.c.o(.data);
        build/SLUS_006.28/src/map_talk.c.o(.data);
        build/SLUS_006.28/src/map_load.c.o(.data);
        build/SLUS_006.28/src/map_view.c.o(.data);
        build/SLUS_006.28/src/map_over.c.o(.data);
        build/SLUS_006.28/src/menu_glyph.c.o(.data);
        build/SLUS_006.28/src/menu_run.c.o(.data);
        build/SLUS_006.28/src/menu_page.c.o(.data);
        build/SLUS_006.28/src/menu_places.c.o(.data);
        build/SLUS_006.28/src/menu_card.c.o(.data);
        build/SLUS_006.28/src/menu_option.c.o(.data);
        build/SLUS_006.28/src/menu_nowalk.c.o(.data);
        build/SLUS_006.28/src/face_list.c.o(.data);
        build/SLUS_006.28/src/menu_use.c.o(.data);
        build/SLUS_006.28/src/menu_list.c.o(.data);
        build/SLUS_006.28/src/map_look.c.o(.data);
        build/SLUS_006.28/src/map_btl.c.o(.data);
        build/SLUS_006.28/src/map_touch.c.o(.data);
        build/SLUS_006.28/src/btl_show.c.o(.data);
        build/SLUS_006.28/src/btl_item.c.o(.data);
        build/SLUS_006.28/src/btl_weapon.c.o(.data);
        build/SLUS_006.28/src/btl_boss.c.o(.data);
        build/SLUS_006.28/src/btl_show_frame.c.o(.data);
        build/SLUS_006.28/src/btl_effect.c.o(.data);
        build/SLUS_006.28/src/libapi_c57.c.o(.data);
        build/SLUS_006.28/src/libapi_c68.c.o(.data);
        build/SLUS_006.28/src/libapi_c112.c.o(.data);
        build/SLUS_006.28/src/libapi_a36.c.o(.data);
        build/SLUS_006.28/src/libapi_a37.c.o(.data);
        build/SLUS_006.28/src/libapi_a50.c.o(.data);
        build/SLUS_006.28/src/libapi_a51.c.o(.data);
        build/SLUS_006.28/src/libapi_a52.c.o(.data);
        build/SLUS_006.28/src/libapi_a53.c.o(.data);
        build/SLUS_006.28/src/libapi_a54.c.o(.data);
        build/SLUS_006.28/src/libapi_a81.c.o(.data);
        build/SLUS_006.28/src/libapi_i_heap2.c.o(.data);
        build/SLUS_006.28/src/libapi_malloc2.c.o(.data);
        build/SLUS_006.28/src/libapi_free2.c.o(.data);
        build/SLUS_006.28/src/libc2_bcopy.c.o(.data);
        build/SLUS_006.28/src/libc2_bzero.c.o(.data);
        build/SLUS_006.28/src/libc2_memset.c.o(.data);
        build/SLUS_006.28/src/libc2_strcmp.c.o(.data);
        build/SLUS_006.28/src/libc2_strcpy.c.o(.data);
        build/SLUS_006.28/src/libc2_strlen.c.o(.data);
        build/SLUS_006.28/src/libgpu_sys_1.c.o(.data);
        build/SLUS_006.28/src/libgpu_sys_2.c.o(.data);
        build/SLUS_006.28/src/libgpu_sys_3.c.o(.data);
        build/SLUS_006.28/src/libgpu_sys_4.c.o(.data);
        build/SLUS_006.28/src/libgpu_sys_5.c.o(.data);
        build/SLUS_006.28/src/libgpu_sys_6.c.o(.data);
        build/SLUS_006.28/src/libapi_c73.c.o(.data);
        build/SLUS_006.28/src/libc2_memcpy.c.o(.data);
        build/SLUS_006.28/src/libgpu_e01.c.o(.data);
        build/SLUS_006.28/src/libgpu_e03.c.o(.data);
        build/SLUS_006.28/src/libgpu_e04.c.o(.data);
        build/SLUS_006.28/src/libgpu_p00.c.o(.data);
        build/SLUS_006.28/src/libgpu_p01.c.o(.data);
        build/SLUS_006.28/src/libgpu_p06.c.o(.data);
        build/SLUS_006.28/src/libgpu_p10.c.o(.data);
        build/SLUS_006.28/src/libgpu_p12.c.o(.data);
        build/SLUS_006.28/src/libgpu_p16.c.o(.data);
        build/SLUS_006.28/src/libgpu_p26.c.o(.data);
        build/SLUS_006.28/src/libgpu_p29.c.o(.data);
        build/SLUS_006.28/src/libgpu_p33.c.o(.data);
        build/SLUS_006.28/src/libgs_gs_001_1.c.o(.data);
        build/SLUS_006.28/src/libgs_gs_001_2.c.o(.data);
        build/SLUS_006.28/src/libgs_gs_001_3.c.o(.data);
        build/SLUS_006.28/src/libgs_gs_002.c.o(.data);
        build/SLUS_006.28/src/libgs_gs_003.c.o(.data);
        build/SLUS_006.28/src/libgs_gs_006.c.o(.data);
        build/SLUS_006.28/src/libgs_gs_007.c.o(.data);
        build/SLUS_006.28/src/libapi_counter_1.c.o(.data);
        build/SLUS_006.28/src/libapi_counter_2.c.o(.data);
        build/SLUS_006.28/src/libgs_gs_008.c.o(.data);
        build/SLUS_006.28/src/libgs_gs_010.c.o(.data);
        build/SLUS_006.28/src/libgs_gs_103.c.o(.data);
        build/SLUS_006.28/src/libgs_gs_104.c.o(.data);
        build/SLUS_006.28/src/libgs_gs_107_1.c.o(.data);
        build/SLUS_006.28/src/libgs_gs_107_2.c.o(.data);
        build/SLUS_006.28/src/libgs_gs_107_3.c.o(.data);
        build/SLUS_006.28/src/libgs_gs_111.c.o(.data);
        build/SLUS_006.28/src/libgs_gs_113.c.o(.data);
        build/SLUS_006.28/src/libgs_gs_121.c.o(.data);
        build/SLUS_006.28/src/libgs_gs_122.c.o(.data);
        build/SLUS_006.28/src/libgs_gs_123.c.o(.data);
        build/SLUS_006.28/src/libgte_msc00.c.o(.data);
        build/SLUS_006.28/src/libgte_msc01.c.o(.data);
        build/SLUS_006.28/src/libgte_mtx_11.c.o(.data);
        build/SLUS_006.28/src/libgte_reg11.c.o(.data);
        build/SLUS_006.28/src/libgte_reg12.c.o(.data);
        build/SLUS_006.28/src/libgte_patchgte.c.o(.data);
        build/SLUS_006.28/src/libcd_cdrom.c.o(.data);
        build/SLUS_006.28/src/libcd_toc_1.c.o(.data);
        build/SLUS_006.28/src/libcd_toc_2.c.o(.data);
        build/SLUS_006.28/src/libcd_event_1.c.o(.data);
        build/SLUS_006.28/src/libcd_event_2.c.o(.data);
        build/SLUS_006.28/src/libapi_a07.c.o(.data);
        build/SLUS_006.28/src/libcd_sys_1.c.o(.data);
        build/SLUS_006.28/src/libcd_sys_2.c.o(.data);
        build/SLUS_006.28/src/libcd_sys_3.c.o(.data);
        build/SLUS_006.28/src/libcd_sys_4.c.o(.data);
        build/SLUS_006.28/src/libcd_sys_5.c.o(.data);
        build/SLUS_006.28/src/libcd_sys_6.c.o(.data);
        build/SLUS_006.28/src/libcd_sys_7.c.o(.data);
        build/SLUS_006.28/src/libcd_bios_1.c.o(.data);
        build/SLUS_006.28/src/libcd_bios_2.c.o(.data);
        build/SLUS_006.28/src/libcd_bios_3.c.o(.data);
        build/SLUS_006.28/src/libc2_puts.c.o(.data);
        build/SLUS_006.28/src/libc2_putchar.c.o(.data);
        build/SLUS_006.28/src/libc2_ctype.c.o(.data);
        build/SLUS_006.28/src/libcd_iso9660.c.o(.data);
        build/SLUS_006.28/src/libc2_strncmp.c.o(.data);
        build/SLUS_006.28/src/libcd_cdread_1.c.o(.data);
        build/SLUS_006.28/src/libcd_cdread_2.c.o(.data);
        build/SLUS_006.28/src/libcd_cdread2_1.c.o(.data);
        build/SLUS_006.28/src/libcd_cdread2_2.c.o(.data);
        build/SLUS_006.28/src/libcd_c_002.c.o(.data);
        build/SLUS_006.28/src/libcd_c_004_1.c.o(.data);
        build/SLUS_006.28/src/libcd_c_004_2.c.o(.data);
        build/SLUS_006.28/src/libcd_c_005.c.o(.data);
        build/SLUS_006.28/src/libcd_c_007.c.o(.data);
        build/SLUS_006.28/src/libcd_c_008.c.o(.data);
        build/SLUS_006.28/src/libcd_c_009.c.o(.data);
        build/SLUS_006.28/src/libcd_c_010.c.o(.data);
        build/SLUS_006.28/src/libcd_c_011_1.c.o(.data);
        build/SLUS_006.28/src/libcd_c_011_2.c.o(.data);
        build/SLUS_006.28/src/libcd_s_002.c.o(.data);
        build/SLUS_006.28/src/libetc_vsync_1.c.o(.data);
        build/SLUS_006.28/src/libetc_vsync_2.c.o(.data);
        build/SLUS_006.28/src/libapi_a91.c.o(.data);
        build/SLUS_006.28/src/libapi_l10.c.o(.data);
        build/SLUS_006.28/src/libetc_intr_1.c.o(.data);
        build/SLUS_006.28/src/libetc_intr_2.c.o(.data);
        build/SLUS_006.28/src/libapi_c114.c.o(.data);
        build/SLUS_006.28/src/libapi_a23.c.o(.data);
        build/SLUS_006.28/src/libapi_a24.c.o(.data);
        build/SLUS_006.28/src/libapi_a25.c.o(.data);
        build/SLUS_006.28/src/libc2_setjmp.c.o(.data);
        build/SLUS_006.28/src/libetc_intr_vb_1.c.o(.data);
        build/SLUS_006.28/src/libetc_intr_vb_2.c.o(.data);
        build/SLUS_006.28/src/libetc_intr_dma_1.c.o(.data);
        build/SLUS_006.28/src/libetc_intr_dma_2.c.o(.data);
        build/SLUS_006.28/src/libetc_vmode.c.o(.data);
        build/SLUS_006.28/src/libsnd_ssclose_1.c.o(.data);
        build/SLUS_006.28/src/libsnd_ssclose_2.c.o(.data);
        build/SLUS_006.28/src/libsnd_ssend.c.o(.data);
        build/SLUS_006.28/src/libsnd_ssinit.c.o(.data);
        build/SLUS_006.28/src/libsnd_ssinit_c.c.o(.data);
        build/SLUS_006.28/src/libsnd_ssloop.c.o(.data);
        build/SLUS_006.28/src/libsnd_ssopenq.c.o(.data);
        build/SLUS_006.28/src/libsnd_cc_0.c.o(.data);
        build/SLUS_006.28/src/libsnd_cc_6.c.o(.data);
        build/SLUS_006.28/src/libsnd_cc_7.c.o(.data);
        build/SLUS_006.28/src/libsnd_cc_10.c.o(.data);
        build/SLUS_006.28/src/libsnd_cc_11.c.o(.data);
        build/SLUS_006.28/src/libsnd_cc_64.c.o(.data);
        build/SLUS_006.28/src/libsnd_cc_91.c.o(.data);
        build/SLUS_006.28/src/libsnd_cc_98.c.o(.data);
        build/SLUS_006.28/src/libsnd_cc_99.c.o(.data);
        build/SLUS_006.28/src/libsnd_cc_100.c.o(.data);
        build/SLUS_006.28/src/libsnd_cc_101.c.o(.data);
        build/SLUS_006.28/src/libsnd_cc_121.c.o(.data);
        build/SLUS_006.28/src/libsnd_de_0.c.o(.data);
        build/SLUS_006.28/src/libsnd_de_1.c.o(.data);
        build/SLUS_006.28/src/libsnd_de_2.c.o(.data);
        build/SLUS_006.28/src/libsnd_de_3.c.o(.data);
        build/SLUS_006.28/src/libsnd_de_4.c.o(.data);
        build/SLUS_006.28/src/libsnd_ccadsr.c.o(.data);
        build/SLUS_006.28/src/libsnd_de_5.c.o(.data);
        build/SLUS_006.28/src/libsnd_de_6.c.o(.data);
        build/SLUS_006.28/src/libsnd_de_7.c.o(.data);
        build/SLUS_006.28/src/libsnd_de_8.c.o(.data);
        build/SLUS_006.28/src/libsnd_de_9.c.o(.data);
        build/SLUS_006.28/src/libsnd_de_10.c.o(.data);
        build/SLUS_006.28/src/libsnd_de_11.c.o(.data);
        build/SLUS_006.28/src/libsnd_de_12.c.o(.data);
        build/SLUS_006.28/src/libsnd_de_13.c.o(.data);
        build/SLUS_006.28/src/libsnd_de_14.c.o(.data);
        build/SLUS_006.28/src/libsnd_de_15.c.o(.data);
        build/SLUS_006.28/src/libsnd_de_16.c.o(.data);
        build/SLUS_006.28/src/libsnd_de_17.c.o(.data);
        build/SLUS_006.28/src/libsnd_de_18.c.o(.data);
        build/SLUS_006.28/src/libsnd_de_19.c.o(.data);
        build/SLUS_006.28/src/libsnd_midibend.c.o(.data);
        build/SLUS_006.28/src/libsnd_midicc.c.o(.data);
        build/SLUS_006.28/src/libsnd_midimeta.c.o(.data);
        build/SLUS_006.28/src/libsnd_midinote.c.o(.data);
        build/SLUS_006.28/src/libsnd_midiprog.c.o(.data);
        build/SLUS_006.28/src/libsnd_miditime.c.o(.data);
        build/SLUS_006.28/src/libsnd_seqinit.c.o(.data);
        build/SLUS_006.28/src/libsnd_ssplay.c.o(.data);
        build/SLUS_006.28/src/libsnd_playmode.c.o(.data);
        build/SLUS_006.28/src/libsnd_ssstart_1.c.o(.data);
        build/SLUS_006.28/src/libsnd_ssstart_2.c.o(.data);
        build/SLUS_006.28/src/libsnd_ssstart_3.c.o(.data);
        build/SLUS_006.28/src/libsnd_ssstart_4.c.o(.data);
        build/SLUS_006.28/src/libsnd_sscall.c.o(.data);
        build/SLUS_006.28/src/libsnd_cres.c.o(.data);
        build/SLUS_006.28/src/libsnd_pause.c.o(.data);
        build/SLUS_006.28/src/libsnd_play.c.o(.data);
        build/SLUS_006.28/src/libsnd_midiread.c.o(.data);
        build/SLUS_006.28/src/libsnd_next.c.o(.data);
        build/SLUS_006.28/src/libsnd_replay.c.o(.data);
        build/SLUS_006.28/src/libsnd_ssstop_1.c.o(.data);
        build/SLUS_006.28/src/libsnd_ssstop_2.c.o(.data);
        build/SLUS_006.28/src/libsnd_sstable.c.o(.data);
        build/SLUS_006.28/src/libsnd_sstick.c.o(.data);
        build/SLUS_006.28/src/libsnd_ssvol.c.o(.data);
        build/SLUS_006.28/src/libsnd_tempo.c.o(.data);
        build/SLUS_006.28/src/libsnd_ut_gpa.c.o(.data);
        build/SLUS_006.28/src/libsnd_ut_gva.c.o(.data);
        build/SLUS_006.28/src/libsnd_ut_rdel.c.o(.data);
        build/SLUS_006.28/src/libsnd_ut_rdep.c.o(.data);
        build/SLUS_006.28/src/libsnd_ut_rev.c.o(.data);
        build/SLUS_006.28/src/libsnd_ut_rfb.c.o(.data);
        build/SLUS_006.28/src/libsnd_ut_roff.c.o(.data);
        build/SLUS_006.28/src/libsnd_ut_ron.c.o(.data);
        build/SLUS_006.28/src/libsnd_ut_sva.c.o(.data);
        build/SLUS_006.28/src/libsnd_vm_doff.c.o(.data);
        build/SLUS_006.28/src/libsnd_vm_don.c.o(.data);
        build/SLUS_006.28/src/libsnd_vm_f.c.o(.data);
        build/SLUS_006.28/src/libsnd_vm_init.c.o(.data);
        build/SLUS_006.28/src/libsnd_vm_key_1.c.o(.data);
        build/SLUS_006.28/src/libsnd_vm_key_2.c.o(.data);
        build/SLUS_006.28/src/libsnd_vm_aloc1.c.o(.data);
        build/SLUS_006.28/src/libsnd_vm_aloc2.c.o(.data);
        build/SLUS_006.28/src/libsnd_vm_n2p.c.o(.data);
        build/SLUS_006.28/src/libsnd_vm_no1.c.o(.data);
        build/SLUS_006.28/src/libsnd_vm_noff.c.o(.data);
        build/SLUS_006.28/src/libsnd_vm_nowof.c.o(.data);
        build/SLUS_006.28/src/libsnd_vm_nowon.c.o(.data);
        build/SLUS_006.28/src/libsnd_vm_pb.c.o(.data);
        build/SLUS_006.28/src/libsnd_vm_prog.c.o(.data);
        build/SLUS_006.28/src/libsnd_vm_seq.c.o(.data);
        build/SLUS_006.28/src/libsnd_vm_stav.c.o(.data);
        build/SLUS_006.28/src/libsnd_vm_vol.c.o(.data);
        build/SLUS_006.28/src/libsnd_vm_vsu.c.o(.data);
        build/SLUS_006.28/src/libsnd_vs_mono.c.o(.data);
        build/SLUS_006.28/src/libsnd_vs_vab.c.o(.data);
        build/SLUS_006.28/src/libsnd_vs_vh2.c.o(.data);
        build/SLUS_006.28/src/libsnd_vs_vh.c.o(.data);
        build/SLUS_006.28/src/libsnd_vs_vtb.c.o(.data);
        build/SLUS_006.28/src/libsnd_vs_vtc.c.o(.data);
        build/SLUS_006.28/src/libspu_s_i.c.o(.data);
        build/SLUS_006.28/src/libspu_s_ini_1.c.o(.data);
        build/SLUS_006.28/src/libspu_s_ini_2.c.o(.data);
        build/SLUS_006.28/src/libapi_a08.c.o(.data);
        build/SLUS_006.28/src/libapi_a12.c.o(.data);
        build/SLUS_006.28/src/libspu_spu_1.c.o(.data);
        build/SLUS_006.28/src/libspu_spu_2.c.o(.data);
        build/SLUS_006.28/src/libspu_spu_3.c.o(.data);
        build/SLUS_006.28/src/libspu_s_dcb.c.o(.data);
        build/SLUS_006.28/src/libspu_s_m_init.c.o(.data);
        build/SLUS_006.28/src/libspu_s_m_m.c.o(.data);
        build/SLUS_006.28/src/libspu_s_m_int.c.o(.data);
        build/SLUS_006.28/src/libspu_s_m_f.c.o(.data);
        build/SLUS_006.28/src/libspu_s_snv.c.o(.data);
        build/SLUS_006.28/src/libspu_s_sav.c.o(.data);
        build/SLUS_006.28/src/libspu_s_gnv.c.o(.data);
        build/SLUS_006.28/src/libspu_s_gav.c.o(.data);
        build/SLUS_006.28/src/libspu_s_snc.c.o(.data);
        build/SLUS_006.28/src/libspu_s_sr.c.o(.data);
        build/SLUS_006.28/src/libspu_s_m_util.c.o(.data);
        build/SLUS_006.28/src/libspu_s_srmp.c.o(.data);
        build/SLUS_006.28/src/libspu_s_sra.c.o(.data);
        build/SLUS_006.28/src/libspu_s_srv.c.o(.data);
        build/SLUS_006.28/src/libspu_s_grv.c.o(.data);
        build/SLUS_006.28/src/libspu_s_crwa.c.o(.data);
        build/SLUS_006.28/src/libapi_a10.c.o(.data);
        build/SLUS_006.28/src/libspu_s_sk.c.o(.data);
        build/SLUS_006.28/src/libspu_s_r.c.o(.data);
        build/SLUS_006.28/src/libspu_s_stsa.c.o(.data);
        build/SLUS_006.28/src/libspu_s_stm.c.o(.data);
        build/SLUS_006.28/src/libspu_s_itc.c.o(.data);
        build/SLUS_006.28/src/libapi_a11.c.o(.data);
        build/SLUS_006.28/src/libspu_s_it.c.o(.data);
        build/SLUS_006.28/src/libspu_s_sva.c.o(.data);
        build/SLUS_006.28/src/libspu_s_n2p.c.o(.data);
        build/SLUS_006.28/src/libspu_s_gvex.c.o(.data);
        build/SLUS_006.28/src/libspu_s_scmv.c.o(.data);
        build/SLUS_006.28/src/libspu_s_sccv.c.o(.data);
        build/SLUS_006.28/src/libspu_s_sccr.c.o(.data);
        build/SLUS_006.28/src/libspu_s_sccm.c.o(.data);
        build/SLUS_006.28/src/libspu_s_srmt.c.o(.data);
        build/SLUS_006.28/src/libspu_s_srmd.c.o(.data);
        build/SLUS_006.28/src/libmcrd_init.c.o(.data);
        build/SLUS_006.28/src/libcard_init.c.o(.data);
        build/SLUS_006.28/src/libapi_pad_1.c.o(.data);
        build/SLUS_006.28/src/libapi_pad_2.c.o(.data);
        build/SLUS_006.28/src/libapi_pad_3.c.o(.data);
        build/SLUS_006.28/src/libapi_pad_4.c.o(.data);
        build/SLUS_006.28/src/libapi_a18.c.o(.data);
        build/SLUS_006.28/src/libapi_a19.c.o(.data);
        build/SLUS_006.28/src/libapi_a20.c.o(.data);
        build/SLUS_006.28/src/libapi_a21.c.o(.data);
        build/SLUS_006.28/src/libapi_l02.c.o(.data);
        build/SLUS_006.28/src/libapi_l03.c.o(.data);
        build/SLUS_006.28/src/libapi_patch.c.o(.data);
        build/SLUS_006.28/src/libapi_chclrpad.c.o(.data);
        build/SLUS_006.28/src/libcard_a74.c.o(.data);
        build/SLUS_006.28/src/libcard_a75.c.o(.data);
        build/SLUS_006.28/src/libcard_a76.c.o(.data);
        build/SLUS_006.28/src/libcard_patch.c.o(.data);
        build/SLUS_006.28/src/libcard_end.c.o(.data);
        build/SLUS_006.28/src/libmcrd_libmcrd_1.c.o(.data);
        build/SLUS_006.28/src/libmcrd_libmcrd_2.c.o(.data);
        build/SLUS_006.28/src/libmcrd_libmcrd_3.c.o(.data);
        build/SLUS_006.28/src/libmcrd_libmcrd_4.c.o(.data);
        build/SLUS_006.28/src/libmcrd_libmcrd_5.c.o(.data);
        build/SLUS_006.28/src/libmcrd_libmcrd_6.c.o(.data);
        build/SLUS_006.28/src/libmcrd_libmcrd_7.c.o(.data);
        build/SLUS_006.28/src/libmcrd_libmcrd_8.c.o(.data);
        build/SLUS_006.28/src/libmcrd_libmcrd_9.c.o(.data);
        build/SLUS_006.28/src/libmcrd_libmcrd_10.c.o(.data);
        build/SLUS_006.28/src/libmcrd_libmcrd_11.c.o(.data);
        build/SLUS_006.28/src/libmcrd_libmcrd_12.c.o(.data);
        build/SLUS_006.28/src/libmcrd_libmcrd_13.c.o(.data);
        build/SLUS_006.28/src/libapi_a67.c.o(.data);
        build/SLUS_006.28/src/libapi_a69.c.o(.data);
        build/SLUS_006.28/src/libapi_first.c.o(.data);
        build/SLUS_006.28/src/libapi_a66.c.o(.data);
        build/SLUS_006.28/src/libc2_strcat.c.o(.data);
        build/SLUS_006.28/src/libcard_c171.c.o(.data);
        build/SLUS_006.28/src/libcard_c172.c.o(.data);
        build/SLUS_006.28/src/libcard_a78.c.o(.data);
        build/SLUS_006.28/src/libcard_a80.c.o(.data);
        build/SLUS_006.28/src/libcard_card.c.o(.data);
        build/SLUS_006.28/src/libmcrd_userfunc_1.c.o(.data);
        build/SLUS_006.28/src/libmcrd_userfunc_2.c.o(.data);
        build/SLUS_006.28/src/libmcrd_userfunc_3.c.o(.data);
        build/SLUS_006.28/src/libmcrd_bios_1.c.o(.data);
        build/SLUS_006.28/src/libmcrd_bios_2.c.o(.data);
        build/SLUS_006.28/src/libmcrd_bios_3.c.o(.data);
        build/SLUS_006.28/src/libmcrd_bios_4.c.o(.data);
        build/SLUS_006.28/src/libmcrd_bios_5.c.o(.data);
        build/SLUS_006.28/src/libmcrd_bios_6.c.o(.data);
        build/SLUS_006.28/src/libmcrd_bios_7.c.o(.data);
        build/SLUS_006.28/src/libapi_a09.c.o(.data);
        build/SLUS_006.28/src/libmcrd_low.c.o(.data);
        build/SLUS_006.28/src/libc2_strncpy.c.o(.data);
        build/SLUS_006.28/src/libcard_a79.c.o(.data);
        build/SLUS_006.28/src/libpad_padentry_1.c.o(.data);
        build/SLUS_006.28/src/libpad_padentry_2.c.o(.data);
        build/SLUS_006.28/src/libpad_padmain.c.o(.data);
        build/SLUS_006.28/src/libpad_padcmd.c.o(.data);
        build/SLUS_006.28/src/libpad_padif.c.o(.data);
        build/SLUS_006.28/src/libpad_padportd.c.o(.data);
        build/SLUS_006.28/src/libpad_padseqd.c.o(.data);
        build/SLUS_006.28/src/libpad_waitrc2.c.o(.data);
        build/SLUS_006.28/asm/data/data_tables.data.s.o(.data);
        . = ALIGN(., 16);
        main_DATA_END = .;
        main_DATA_SIZE = ABSOLUTE(main_DATA_END - main_DATA_START);
        main_RODATA_START = .;
        build/SLUS_006.28/src/2mbyte.c.o(.rodata);
        build/SLUS_006.28/src/main.c.o(.rodata);
        build/SLUS_006.28/src/bg_cover.c.o(.rodata);
        build/SLUS_006.28/src/shop_strings.c.o(.rodata);
        build/SLUS_006.28/src/mem_request.c.o(.rodata);
        build/SLUS_006.28/src/shop_face.c.o(.rodata);
        build/SLUS_006.28/src/layer_mix.c.o(.rodata);
        build/SLUS_006.28/src/music_play.c.o(.rodata);
        build/SLUS_006.28/src/music_bank.c.o(.rodata);
        build/SLUS_006.28/src/music_voice.c.o(.rodata);
        build/SLUS_006.28/src/map_frame.c.o(.rodata);
        build/SLUS_006.28/src/game_start.c.o(.rodata);
        build/SLUS_006.28/src/map_step.c.o(.rodata);
        build/SLUS_006.28/src/chr_level.c.o(.rodata);
        build/SLUS_006.28/src/map_endcopy.c.o(.rodata);
        build/SLUS_006.28/src/map_fade.c.o(.rodata);
        build/SLUS_006.28/src/cell_text.c.o(.rodata);
        build/SLUS_006.28/src/cell_face.c.o(.rodata);
        build/SLUS_006.28/src/story.c.o(.rodata);
        build/SLUS_006.28/src/chr_item.c.o(.rodata);
        build/SLUS_006.28/src/menu_places.c.o(.rodata);
        build/SLUS_006.28/src/menu_card.c.o(.rodata);
        build/SLUS_006.28/src/menu_option.c.o(.rodata);
        build/SLUS_006.28/src/menu_nowalk.c.o(.rodata);
        build/SLUS_006.28/src/face_list.c.o(.rodata);
        build/SLUS_006.28/src/menu_use.c.o(.rodata);
        build/SLUS_006.28/src/map_touch.c.o(.rodata);
        build/SLUS_006.28/src/btl_show.c.o(.rodata);
        build/SLUS_006.28/src/btl_item.c.o(.rodata);
        build/SLUS_006.28/src/btl_show_frame.c.o(.rodata);
        build/SLUS_006.28/src/btl_effect.c.o(.rodata);
        build/SLUS_006.28/src/libapi_c57.c.o(.rodata);
        build/SLUS_006.28/src/libapi_c68.c.o(.rodata);
        build/SLUS_006.28/src/libapi_c112.c.o(.rodata);
        build/SLUS_006.28/src/libapi_a36.c.o(.rodata);
        build/SLUS_006.28/src/libapi_a37.c.o(.rodata);
        build/SLUS_006.28/src/libapi_a50.c.o(.rodata);
        build/SLUS_006.28/src/libapi_a51.c.o(.rodata);
        build/SLUS_006.28/src/libapi_a52.c.o(.rodata);
        build/SLUS_006.28/src/libapi_a53.c.o(.rodata);
        build/SLUS_006.28/src/libapi_a54.c.o(.rodata);
        build/SLUS_006.28/src/libapi_a81.c.o(.rodata);
        build/SLUS_006.28/src/libapi_i_heap2.c.o(.rodata);
        build/SLUS_006.28/src/libapi_malloc2.c.o(.rodata);
        build/SLUS_006.28/src/libapi_free2.c.o(.rodata);
        build/SLUS_006.28/src/libc2_bcopy.c.o(.rodata);
        build/SLUS_006.28/src/libc2_bzero.c.o(.rodata);
        build/SLUS_006.28/src/libc2_memset.c.o(.rodata);
        build/SLUS_006.28/src/libc2_strcmp.c.o(.rodata);
        build/SLUS_006.28/src/libc2_strcpy.c.o(.rodata);
        build/SLUS_006.28/src/libc2_strlen.c.o(.rodata);
        build/SLUS_006.28/src/libgpu_sys_1.c.o(.rodata);
        build/SLUS_006.28/src/libgpu_sys_2.c.o(.rodata);
        build/SLUS_006.28/src/libgpu_sys_3.c.o(.rodata);
        build/SLUS_006.28/src/libgpu_sys_4.c.o(.rodata);
        build/SLUS_006.28/src/libgpu_sys_5.c.o(.rodata);
        build/SLUS_006.28/src/libgpu_sys_6.c.o(.rodata);
        build/SLUS_006.28/src/libapi_c73.c.o(.rodata);
        build/SLUS_006.28/src/libc2_memcpy.c.o(.rodata);
        build/SLUS_006.28/src/libgpu_e01.c.o(.rodata);
        build/SLUS_006.28/src/libgpu_e03.c.o(.rodata);
        build/SLUS_006.28/src/libgpu_e04.c.o(.rodata);
        build/SLUS_006.28/src/libgpu_p00.c.o(.rodata);
        build/SLUS_006.28/src/libgpu_p01.c.o(.rodata);
        build/SLUS_006.28/src/libgpu_p06.c.o(.rodata);
        build/SLUS_006.28/src/libgpu_p10.c.o(.rodata);
        build/SLUS_006.28/src/libgpu_p12.c.o(.rodata);
        build/SLUS_006.28/src/libgpu_p16.c.o(.rodata);
        build/SLUS_006.28/src/libgpu_p26.c.o(.rodata);
        build/SLUS_006.28/src/libgpu_p29.c.o(.rodata);
        build/SLUS_006.28/src/libgpu_p33.c.o(.rodata);
        build/SLUS_006.28/src/libgs_gs_001_1.c.o(.rodata);
        build/SLUS_006.28/src/libgs_gs_001_2.c.o(.rodata);
        build/SLUS_006.28/src/libgs_gs_001_3.c.o(.rodata);
        build/SLUS_006.28/src/libgs_gs_002.c.o(.rodata);
        build/SLUS_006.28/src/libgs_gs_003.c.o(.rodata);
        build/SLUS_006.28/src/libgs_gs_006.c.o(.rodata);
        build/SLUS_006.28/src/libgs_gs_007.c.o(.rodata);
        build/SLUS_006.28/src/libapi_counter_1.c.o(.rodata);
        build/SLUS_006.28/src/libapi_counter_2.c.o(.rodata);
        build/SLUS_006.28/src/libgs_gs_008.c.o(.rodata);
        build/SLUS_006.28/src/libgs_gs_010.c.o(.rodata);
        build/SLUS_006.28/src/libgs_gs_103.c.o(.rodata);
        build/SLUS_006.28/src/libgs_gs_104.c.o(.rodata);
        build/SLUS_006.28/src/libgs_gs_107_1.c.o(.rodata);
        build/SLUS_006.28/src/libgs_gs_107_2.c.o(.rodata);
        build/SLUS_006.28/src/libgs_gs_107_3.c.o(.rodata);
        build/SLUS_006.28/src/libgte_msc01.c.o(.rodata);
        build/SLUS_006.28/src/libgte_mtx_11.c.o(.rodata);
        build/SLUS_006.28/src/libgte_reg11.c.o(.rodata);
        build/SLUS_006.28/src/libgte_reg12.c.o(.rodata);
        build/SLUS_006.28/src/libgte_patchgte.c.o(.rodata);
        build/SLUS_006.28/src/libcd_cdrom.c.o(.rodata);
        build/SLUS_006.28/src/libcd_toc_1.c.o(.rodata);
        build/SLUS_006.28/src/libcd_toc_2.c.o(.rodata);
        build/SLUS_006.28/src/libcd_event_1.c.o(.rodata);
        build/SLUS_006.28/src/libcd_event_2.c.o(.rodata);
        build/SLUS_006.28/src/libapi_a07.c.o(.rodata);
        build/SLUS_006.28/src/libcd_sys_1.c.o(.rodata);
        build/SLUS_006.28/src/libcd_sys_2.c.o(.rodata);
        build/SLUS_006.28/src/libcd_sys_3.c.o(.rodata);
        build/SLUS_006.28/src/libcd_sys_4.c.o(.rodata);
        build/SLUS_006.28/src/libcd_sys_5.c.o(.rodata);
        build/SLUS_006.28/src/libcd_sys_6.c.o(.rodata);
        build/SLUS_006.28/src/libcd_sys_7.c.o(.rodata);
        build/SLUS_006.28/src/libcd_bios_2.c.o(.rodata);
        build/SLUS_006.28/src/libcd_bios_3.c.o(.rodata);
        build/SLUS_006.28/src/libc2_puts.c.o(.rodata);
        build/SLUS_006.28/src/libc2_putchar.c.o(.rodata);
        build/SLUS_006.28/src/libc2_ctype.c.o(.rodata);
        build/SLUS_006.28/src/libcd_iso9660.c.o(.rodata);
        build/SLUS_006.28/src/libc2_strncmp.c.o(.rodata);
        build/SLUS_006.28/src/libcd_cdread_1.c.o(.rodata);
        build/SLUS_006.28/src/libcd_cdread_2.c.o(.rodata);
        build/SLUS_006.28/src/libcd_cdread2_1.c.o(.rodata);
        build/SLUS_006.28/src/libcd_cdread2_2.c.o(.rodata);
        build/SLUS_006.28/src/libcd_c_002.c.o(.rodata);
        build/SLUS_006.28/src/libcd_c_004_1.c.o(.rodata);
        build/SLUS_006.28/src/libcd_c_004_2.c.o(.rodata);
        build/SLUS_006.28/src/libcd_c_005.c.o(.rodata);
        build/SLUS_006.28/src/libcd_c_007.c.o(.rodata);
        build/SLUS_006.28/src/libcd_c_008.c.o(.rodata);
        build/SLUS_006.28/src/libcd_c_009.c.o(.rodata);
        build/SLUS_006.28/src/libcd_c_010.c.o(.rodata);
        build/SLUS_006.28/src/libcd_c_011_1.c.o(.rodata);
        build/SLUS_006.28/src/libcd_c_011_2.c.o(.rodata);
        build/SLUS_006.28/src/libcd_s_002.c.o(.rodata);
        build/SLUS_006.28/src/libetc_vsync_1.c.o(.rodata);
        build/SLUS_006.28/src/libetc_vsync_2.c.o(.rodata);
        build/SLUS_006.28/src/libapi_a91.c.o(.rodata);
        build/SLUS_006.28/src/libapi_l10.c.o(.rodata);
        build/SLUS_006.28/src/libetc_intr_1.c.o(.rodata);
        build/SLUS_006.28/src/libetc_intr_2.c.o(.rodata);
        build/SLUS_006.28/src/libapi_c114.c.o(.rodata);
        build/SLUS_006.28/src/libapi_a23.c.o(.rodata);
        build/SLUS_006.28/src/libapi_a24.c.o(.rodata);
        build/SLUS_006.28/src/libapi_a25.c.o(.rodata);
        build/SLUS_006.28/src/libc2_setjmp.c.o(.rodata);
        build/SLUS_006.28/src/libetc_intr_vb_1.c.o(.rodata);
        build/SLUS_006.28/src/libetc_intr_vb_2.c.o(.rodata);
        build/SLUS_006.28/src/libetc_intr_dma_1.c.o(.rodata);
        build/SLUS_006.28/src/libetc_intr_dma_2.c.o(.rodata);
        build/SLUS_006.28/src/libetc_vmode.c.o(.rodata);
        build/SLUS_006.28/src/libsnd_ssclose_1.c.o(.rodata);
        build/SLUS_006.28/src/libsnd_ssclose_2.c.o(.rodata);
        build/SLUS_006.28/src/libsnd_ssend.c.o(.rodata);
        build/SLUS_006.28/src/libsnd_ssinit.c.o(.rodata);
        build/SLUS_006.28/src/libsnd_ssinit_c.c.o(.rodata);
        build/SLUS_006.28/src/libsnd_ssloop.c.o(.rodata);
        build/SLUS_006.28/src/libsnd_ssopenq.c.o(.rodata);
        build/SLUS_006.28/src/libsnd_cc_0.c.o(.rodata);
        build/SLUS_006.28/src/libsnd_cc_6.c.o(.rodata);
        build/SLUS_006.28/src/libsnd_cc_7.c.o(.rodata);
        build/SLUS_006.28/src/libsnd_cc_10.c.o(.rodata);
        build/SLUS_006.28/src/libsnd_cc_11.c.o(.rodata);
        build/SLUS_006.28/src/libsnd_cc_64.c.o(.rodata);
        build/SLUS_006.28/src/libsnd_cc_91.c.o(.rodata);
        build/SLUS_006.28/src/libsnd_cc_98.c.o(.rodata);
        build/SLUS_006.28/src/libsnd_cc_99.c.o(.rodata);
        build/SLUS_006.28/src/libsnd_cc_100.c.o(.rodata);
        build/SLUS_006.28/src/libsnd_cc_101.c.o(.rodata);
        build/SLUS_006.28/src/libsnd_cc_121.c.o(.rodata);
        build/SLUS_006.28/src/libsnd_de_0.c.o(.rodata);
        build/SLUS_006.28/src/libsnd_de_1.c.o(.rodata);
        build/SLUS_006.28/src/libsnd_de_2.c.o(.rodata);
        build/SLUS_006.28/src/libsnd_de_3.c.o(.rodata);
        build/SLUS_006.28/src/libsnd_de_4.c.o(.rodata);
        build/SLUS_006.28/src/libsnd_ccadsr.c.o(.rodata);
        build/SLUS_006.28/src/libsnd_de_5.c.o(.rodata);
        build/SLUS_006.28/src/libsnd_de_6.c.o(.rodata);
        build/SLUS_006.28/src/libsnd_de_7.c.o(.rodata);
        build/SLUS_006.28/src/libsnd_de_8.c.o(.rodata);
        build/SLUS_006.28/src/libsnd_de_9.c.o(.rodata);
        build/SLUS_006.28/src/libsnd_de_10.c.o(.rodata);
        build/SLUS_006.28/src/libsnd_de_11.c.o(.rodata);
        build/SLUS_006.28/src/libsnd_de_12.c.o(.rodata);
        build/SLUS_006.28/src/libsnd_de_13.c.o(.rodata);
        build/SLUS_006.28/src/libsnd_de_14.c.o(.rodata);
        build/SLUS_006.28/src/libsnd_de_15.c.o(.rodata);
        build/SLUS_006.28/src/libsnd_de_16.c.o(.rodata);
        build/SLUS_006.28/src/libsnd_de_17.c.o(.rodata);
        build/SLUS_006.28/src/libsnd_de_18.c.o(.rodata);
        build/SLUS_006.28/src/libsnd_de_19.c.o(.rodata);
        build/SLUS_006.28/src/libsnd_midibend.c.o(.rodata);
        build/SLUS_006.28/src/libsnd_midicc.c.o(.rodata);
        build/SLUS_006.28/src/libsnd_midimeta.c.o(.rodata);
        build/SLUS_006.28/src/libsnd_midinote.c.o(.rodata);
        build/SLUS_006.28/src/libsnd_midiprog.c.o(.rodata);
        build/SLUS_006.28/src/libsnd_miditime.c.o(.rodata);
        build/SLUS_006.28/src/libsnd_seqinit.c.o(.rodata);
        build/SLUS_006.28/src/libsnd_ssplay.c.o(.rodata);
        build/SLUS_006.28/src/libsnd_playmode.c.o(.rodata);
        build/SLUS_006.28/src/libsnd_ssstart_1.c.o(.rodata);
        build/SLUS_006.28/src/libsnd_ssstart_2.c.o(.rodata);
        build/SLUS_006.28/src/libsnd_ssstart_3.c.o(.rodata);
        build/SLUS_006.28/src/libsnd_ssstart_4.c.o(.rodata);
        build/SLUS_006.28/src/libsnd_sscall.c.o(.rodata);
        build/SLUS_006.28/src/libsnd_cres.c.o(.rodata);
        build/SLUS_006.28/src/libsnd_pause.c.o(.rodata);
        build/SLUS_006.28/src/libsnd_play.c.o(.rodata);
        build/SLUS_006.28/src/libsnd_midiread.c.o(.rodata);
        build/SLUS_006.28/src/libsnd_next.c.o(.rodata);
        build/SLUS_006.28/src/libsnd_replay.c.o(.rodata);
        build/SLUS_006.28/src/libsnd_ssstop_1.c.o(.rodata);
        build/SLUS_006.28/src/libsnd_ssstop_2.c.o(.rodata);
        build/SLUS_006.28/src/libsnd_sstable.c.o(.rodata);
        build/SLUS_006.28/src/libsnd_ssvol.c.o(.rodata);
        build/SLUS_006.28/src/libsnd_tempo.c.o(.rodata);
        build/SLUS_006.28/src/libsnd_ut_gpa.c.o(.rodata);
        build/SLUS_006.28/src/libsnd_ut_gva.c.o(.rodata);
        build/SLUS_006.28/src/libsnd_ut_rdel.c.o(.rodata);
        build/SLUS_006.28/src/libsnd_ut_rdep.c.o(.rodata);
        build/SLUS_006.28/src/libsnd_ut_rev.c.o(.rodata);
        build/SLUS_006.28/src/libsnd_ut_rfb.c.o(.rodata);
        build/SLUS_006.28/src/libsnd_ut_roff.c.o(.rodata);
        build/SLUS_006.28/src/libsnd_ut_ron.c.o(.rodata);
        build/SLUS_006.28/src/libsnd_ut_sva.c.o(.rodata);
        build/SLUS_006.28/src/libsnd_vm_doff.c.o(.rodata);
        build/SLUS_006.28/src/libsnd_vm_don.c.o(.rodata);
        build/SLUS_006.28/src/libsnd_vm_f.c.o(.rodata);
        build/SLUS_006.28/src/libsnd_vm_init.c.o(.rodata);
        build/SLUS_006.28/src/libsnd_vm_key_1.c.o(.rodata);
        build/SLUS_006.28/src/libsnd_vm_key_2.c.o(.rodata);
        build/SLUS_006.28/src/libsnd_vm_aloc1.c.o(.rodata);
        build/SLUS_006.28/src/libsnd_vm_aloc2.c.o(.rodata);
        build/SLUS_006.28/src/libsnd_vm_n2p.c.o(.rodata);
        build/SLUS_006.28/src/libsnd_vm_no1.c.o(.rodata);
        build/SLUS_006.28/src/libsnd_vm_noff.c.o(.rodata);
        build/SLUS_006.28/src/libsnd_vm_nowof.c.o(.rodata);
        build/SLUS_006.28/src/libsnd_vm_nowon.c.o(.rodata);
        build/SLUS_006.28/src/libsnd_vm_pb.c.o(.rodata);
        build/SLUS_006.28/src/libsnd_vm_prog.c.o(.rodata);
        build/SLUS_006.28/src/libsnd_vm_seq.c.o(.rodata);
        build/SLUS_006.28/src/libsnd_vm_stav.c.o(.rodata);
        build/SLUS_006.28/src/libsnd_vm_vol.c.o(.rodata);
        build/SLUS_006.28/src/libsnd_vm_vsu.c.o(.rodata);
        build/SLUS_006.28/src/libsnd_vs_mono.c.o(.rodata);
        build/SLUS_006.28/src/libsnd_vs_vab.c.o(.rodata);
        build/SLUS_006.28/src/libsnd_vs_vh2.c.o(.rodata);
        build/SLUS_006.28/src/libsnd_vs_vh.c.o(.rodata);
        build/SLUS_006.28/src/libsnd_vs_vtb.c.o(.rodata);
        build/SLUS_006.28/src/libsnd_vs_vtc.c.o(.rodata);
        build/SLUS_006.28/src/libspu_s_i.c.o(.rodata);
        build/SLUS_006.28/src/libspu_s_ini_1.c.o(.rodata);
        build/SLUS_006.28/src/libspu_s_ini_2.c.o(.rodata);
        build/SLUS_006.28/src/libapi_a08.c.o(.rodata);
        build/SLUS_006.28/src/libapi_a12.c.o(.rodata);
        build/SLUS_006.28/src/libspu_spu_1.c.o(.rodata);
        build/SLUS_006.28/src/libspu_spu_2.c.o(.rodata);
        build/SLUS_006.28/src/libspu_spu_3.c.o(.rodata);
        build/SLUS_006.28/src/libspu_s_dcb.c.o(.rodata);
        build/SLUS_006.28/src/libspu_s_m_init.c.o(.rodata);
        build/SLUS_006.28/src/libspu_s_m_m.c.o(.rodata);
        build/SLUS_006.28/src/libspu_s_m_int.c.o(.rodata);
        build/SLUS_006.28/src/libspu_s_m_f.c.o(.rodata);
        build/SLUS_006.28/src/libspu_s_snv.c.o(.rodata);
        build/SLUS_006.28/src/libspu_s_sav.c.o(.rodata);
        build/SLUS_006.28/src/libspu_s_gnv.c.o(.rodata);
        build/SLUS_006.28/src/libspu_s_gav.c.o(.rodata);
        build/SLUS_006.28/src/libspu_s_snc.c.o(.rodata);
        build/SLUS_006.28/src/libspu_s_sr.c.o(.rodata);
        build/SLUS_006.28/src/libspu_s_m_util.c.o(.rodata);
        build/SLUS_006.28/src/libspu_s_srmp.c.o(.rodata);
        build/SLUS_006.28/src/libspu_s_sra.c.o(.rodata);
        build/SLUS_006.28/src/libspu_s_srv.c.o(.rodata);
        build/SLUS_006.28/src/libspu_s_grv.c.o(.rodata);
        build/SLUS_006.28/src/libspu_s_crwa.c.o(.rodata);
        build/SLUS_006.28/src/libapi_a10.c.o(.rodata);
        build/SLUS_006.28/src/libspu_s_sk.c.o(.rodata);
        build/SLUS_006.28/src/libspu_s_r.c.o(.rodata);
        build/SLUS_006.28/src/libspu_s_stsa.c.o(.rodata);
        build/SLUS_006.28/src/libmcrd_init.c.o(.rodata);
        build/SLUS_006.28/src/libcard_init.c.o(.rodata);
        build/SLUS_006.28/src/libapi_pad_1.c.o(.rodata);
        build/SLUS_006.28/src/libapi_pad_2.c.o(.rodata);
        build/SLUS_006.28/src/libapi_pad_3.c.o(.rodata);
        build/SLUS_006.28/src/libapi_pad_4.c.o(.rodata);
        build/SLUS_006.28/src/libapi_a18.c.o(.rodata);
        build/SLUS_006.28/src/libapi_a19.c.o(.rodata);
        build/SLUS_006.28/src/libapi_a20.c.o(.rodata);
        build/SLUS_006.28/src/libapi_a21.c.o(.rodata);
        build/SLUS_006.28/src/libapi_l02.c.o(.rodata);
        build/SLUS_006.28/src/libapi_l03.c.o(.rodata);
        build/SLUS_006.28/src/libapi_patch.c.o(.rodata);
        build/SLUS_006.28/src/libapi_chclrpad.c.o(.rodata);
        build/SLUS_006.28/src/libcard_a74.c.o(.rodata);
        build/SLUS_006.28/src/libcard_a75.c.o(.rodata);
        build/SLUS_006.28/src/libcard_a76.c.o(.rodata);
        build/SLUS_006.28/src/libcard_patch.c.o(.rodata);
        build/SLUS_006.28/src/libcard_end.c.o(.rodata);
        build/SLUS_006.28/src/libmcrd_libmcrd_1.c.o(.rodata);
        build/SLUS_006.28/src/libmcrd_libmcrd_2.c.o(.rodata);
        build/SLUS_006.28/src/libmcrd_libmcrd_3.c.o(.rodata);
        build/SLUS_006.28/src/libmcrd_libmcrd_4.c.o(.rodata);
        build/SLUS_006.28/src/libmcrd_libmcrd_6.c.o(.rodata);
        build/SLUS_006.28/src/libmcrd_libmcrd_7.c.o(.rodata);
        build/SLUS_006.28/src/libmcrd_libmcrd_8.c.o(.rodata);
        build/SLUS_006.28/src/libmcrd_libmcrd_10.c.o(.rodata);
        build/SLUS_006.28/src/libmcrd_libmcrd_11.c.o(.rodata);
        build/SLUS_006.28/src/libmcrd_libmcrd_12.c.o(.rodata);
        build/SLUS_006.28/src/libmcrd_libmcrd_13.c.o(.rodata);
        build/SLUS_006.28/src/libapi_a67.c.o(.rodata);
        build/SLUS_006.28/src/libapi_a69.c.o(.rodata);
        build/SLUS_006.28/src/libapi_first.c.o(.rodata);
        build/SLUS_006.28/src/libapi_a66.c.o(.rodata);
        build/SLUS_006.28/src/libc2_strcat.c.o(.rodata);
        build/SLUS_006.28/src/libcard_c171.c.o(.rodata);
        build/SLUS_006.28/src/libcard_c172.c.o(.rodata);
        build/SLUS_006.28/src/libcard_a78.c.o(.rodata);
        build/SLUS_006.28/src/libcard_a80.c.o(.rodata);
        build/SLUS_006.28/src/libcard_card.c.o(.rodata);
        build/SLUS_006.28/src/libmcrd_userfunc_1.c.o(.rodata);
        build/SLUS_006.28/src/libmcrd_userfunc_2.c.o(.rodata);
        build/SLUS_006.28/src/libmcrd_userfunc_3.c.o(.rodata);
        build/SLUS_006.28/src/libmcrd_bios_1.c.o(.rodata);
        build/SLUS_006.28/src/libmcrd_bios_2.c.o(.rodata);
        build/SLUS_006.28/src/libmcrd_bios_3.c.o(.rodata);
        build/SLUS_006.28/src/libmcrd_bios_4.c.o(.rodata);
        build/SLUS_006.28/src/libmcrd_bios_5.c.o(.rodata);
        build/SLUS_006.28/src/libmcrd_bios_6.c.o(.rodata);
        build/SLUS_006.28/src/libmcrd_bios_7.c.o(.rodata);
        build/SLUS_006.28/src/libapi_a09.c.o(.rodata);
        build/SLUS_006.28/src/libmcrd_low.c.o(.rodata);
        build/SLUS_006.28/src/libc2_strncpy.c.o(.rodata);
        build/SLUS_006.28/src/libcard_a79.c.o(.rodata);
        build/SLUS_006.28/src/libpad_padentry_1.c.o(.rodata);
        build/SLUS_006.28/src/libpad_padmain.c.o(.rodata);
        build/SLUS_006.28/src/libpad_padcmd.c.o(.rodata);
        build/SLUS_006.28/src/libpad_padif.c.o(.rodata);
        build/SLUS_006.28/src/libpad_padportd.c.o(.rodata);
        build/SLUS_006.28/src/libpad_padseqd.c.o(.rodata);
        build/SLUS_006.28/src/libpad_waitrc2.c.o(.rodata);
        . = ALIGN(., 16);
        main_RODATA_END = .;
        main_RODATA_SIZE = ABSOLUTE(main_RODATA_END - main_RODATA_START);
        main_BSS_START = .;
        build/SLUS_006.28/src/2mbyte.c.o(.bss);
        build/SLUS_006.28/src/main.c.o(.bss);
        build/SLUS_006.28/src/bg_cover.c.o(.bss);
        build/SLUS_006.28/src/bg_tile.c.o(.bss);
        build/SLUS_006.28/src/packet_shape.c.o(.bss);
        build/SLUS_006.28/src/message_draw.c.o(.bss);
        build/SLUS_006.28/src/start_picture.c.o(.bss);
        build/SLUS_006.28/src/font_cell.c.o(.bss);
        build/SLUS_006.28/src/sprite_draw.c.o(.bss);
        build/SLUS_006.28/src/btl_draw.c.o(.bss);
        build/SLUS_006.28/src/sprite_list.c.o(.bss);
        build/SLUS_006.28/src/icon.c.o(.bss);
        build/SLUS_006.28/src/exception.c.o(.bss);
        build/SLUS_006.28/src/face.c.o(.bss);
        build/SLUS_006.28/src/cd_track.c.o(.bss);
        build/SLUS_006.28/src/outline.c.o(.bss);
        build/SLUS_006.28/src/screen_fade.c.o(.bss);
        build/SLUS_006.28/src/layer_grey.c.o(.bss);
        build/SLUS_006.28/src/rng.c.o(.bss);
        build/SLUS_006.28/src/mth_curv.c.o(.bss);
        build/SLUS_006.28/src/tile_layer.c.o(.bss);
        build/SLUS_006.28/src/layer_col.c.o(.bss);
        build/SLUS_006.28/src/frame.c.o(.bss);
        build/SLUS_006.28/src/pad_update.c.o(.bss);
        build/SLUS_006.28/src/pad_start.c.o(.bss);
        build/SLUS_006.28/src/palette_buf.c.o(.bss);
        build/SLUS_006.28/src/resource_load.c.o(.bss);
        build/SLUS_006.28/src/tpage.c.o(.bss);
        build/SLUS_006.28/src/palette_row.c.o(.bss);
        build/SLUS_006.28/src/resource_command.c.o(.bss);
        build/SLUS_006.28/src/map_resource.c.o(.bss);
        build/SLUS_006.28/src/cdread.c.o(.bss);
        build/SLUS_006.28/src/fmt.c.o(.bss);
        build/SLUS_006.28/src/inflate.c.o(.bss);
        build/SLUS_006.28/src/xmalloc.c.o(.bss);
        build/SLUS_006.28/src/overlay.c.o(.bss);
        build/SLUS_006.28/src/xa.c.o(.bss);
        build/SLUS_006.28/src/sound.c.o(.bss);
        build/SLUS_006.28/src/picture.c.o(.bss);
        build/SLUS_006.28/src/cd_change.c.o(.bss);
        build/SLUS_006.28/src/card.c.o(.bss);
        build/SLUS_006.28/src/packet_sprite.c.o(.bss);
        build/SLUS_006.28/src/ankprint.c.o(.bss);
        build/SLUS_006.28/src/profile.c.o(.bss);
        build/SLUS_006.28/src/screen_wait.c.o(.bss);
        build/SLUS_006.28/src/mem_move.c.o(.bss);
        build/SLUS_006.28/src/palette_animation.c.o(.bss);
        build/SLUS_006.28/src/tile_animation.c.o(.bss);
        build/SLUS_006.28/src/pad_record.c.o(.bss);
        build/SLUS_006.28/src/font_string.c.o(.bss);
        build/SLUS_006.28/src/btl_animation.c.o(.bss);
        build/SLUS_006.28/src/btl_run.c.o(.bss);
        build/SLUS_006.28/src/chr_levelup.c.o(.bss);
        build/SLUS_006.28/src/btl_end.c.o(.bss);
        build/SLUS_006.28/src/btl_round.c.o(.bss);
        build/SLUS_006.28/src/btl_init.c.o(.bss);
        build/SLUS_006.28/src/btl_walk.c.o(.bss);
        build/SLUS_006.28/src/btl_path.c.o(.bss);
        build/SLUS_006.28/src/btl_action.c.o(.bss);
        build/SLUS_006.28/src/btl_status.c.o(.bss);
        build/SLUS_006.28/src/btl_hit.c.o(.bss);
        build/SLUS_006.28/src/btl_attack.c.o(.bss);
        build/SLUS_006.28/src/btl_row.c.o(.bss);
        build/SLUS_006.28/src/btl_target.c.o(.bss);
        build/SLUS_006.28/src/btl_move.c.o(.bss);
        build/SLUS_006.28/src/btl_slot.c.o(.bss);
        build/SLUS_006.28/src/btl_fall.c.o(.bss);
        build/SLUS_006.28/src/btl_frame.c.o(.bss);
        build/SLUS_006.28/src/btl_pick.c.o(.bss);
        build/SLUS_006.28/src/btl_acting.c.o(.bss);
        build/SLUS_006.28/src/btl_enemy.c.o(.bss);
        build/SLUS_006.28/src/btl_outcome.c.o(.bss);
        build/SLUS_006.28/src/btl_plan.c.o(.bss);
        build/SLUS_006.28/src/start_screen.c.o(.bss);
        build/SLUS_006.28/src/btl_menu.c.o(.bss);
        build/SLUS_006.28/src/btl_command.c.o(.bss);
        build/SLUS_006.28/src/btl_window.c.o(.bss);
        build/SLUS_006.28/src/btl_amount.c.o(.bss);
        build/SLUS_006.28/src/btl_panel.c.o(.bss);
        build/SLUS_006.28/src/btl_message.c.o(.bss);
        build/SLUS_006.28/src/btl_choice.c.o(.bss);
        build/SLUS_006.28/src/shop_run.c.o(.bss);
        build/SLUS_006.28/src/shop_screen.c.o(.bss);
        build/SLUS_006.28/src/shop_strings.c.o(.bss);
        build/SLUS_006.28/src/mem_request.c.o(.bss);
        build/SLUS_006.28/src/shop_face.c.o(.bss);
        build/SLUS_006.28/src/layer_mix.c.o(.bss);
        build/SLUS_006.28/src/music_play.c.o(.bss);
        build/SLUS_006.28/src/music_bank.c.o(.bss);
        build/SLUS_006.28/src/music_voice.c.o(.bss);
        build/SLUS_006.28/src/map_frame.c.o(.bss);
        build/SLUS_006.28/src/game_start.c.o(.bss);
        build/SLUS_006.28/src/map_step.c.o(.bss);
        build/SLUS_006.28/src/chr_level.c.o(.bss);
        build/SLUS_006.28/src/map_endcopy.c.o(.bss);
        build/SLUS_006.28/src/map_fade.c.o(.bss);
        build/SLUS_006.28/src/cell_text.c.o(.bss);
        build/SLUS_006.28/src/cell_face.c.o(.bss);
        build/SLUS_006.28/src/story.c.o(.bss);
        build/SLUS_006.28/src/chr_item.c.o(.bss);
        build/SLUS_006.28/src/chr_worn.c.o(.bss);
        build/SLUS_006.28/src/map_music.c.o(.bss);
        build/SLUS_006.28/src/movie.c.o(.bss);
        build/SLUS_006.28/src/map_attribute.c.o(.bss);
        build/SLUS_006.28/src/map_change.c.o(.bss);
        build/SLUS_006.28/src/script_run.c.o(.bss);
        build/SLUS_006.28/src/message_disp.c.o(.bss);
        build/SLUS_006.28/src/lns_intp.c.o(.bss);
        build/SLUS_006.28/src/lns_move.c.o(.bss);
        build/SLUS_006.28/src/script_move.c.o(.bss);
        build/SLUS_006.28/src/move_command.c.o(.bss);
        build/SLUS_006.28/src/step_command.c.o(.bss);
        build/SLUS_006.28/src/map_sprite.c.o(.bss);
        build/SLUS_006.28/src/map_party.c.o(.bss);
        build/SLUS_006.28/src/party.c.o(.bss);
        build/SLUS_006.28/src/map_object.c.o(.bss);
        build/SLUS_006.28/src/map_animation.c.o(.bss);
        build/SLUS_006.28/src/map_walk.c.o(.bss);
        build/SLUS_006.28/src/map_ring.c.o(.bss);
        build/SLUS_006.28/src/map_think.c.o(.bss);
        build/SLUS_006.28/src/map_talk.c.o(.bss);
        build/SLUS_006.28/src/map_load.c.o(.bss);
        build/SLUS_006.28/src/map_view.c.o(.bss);
        build/SLUS_006.28/src/map_over.c.o(.bss);
        build/SLUS_006.28/src/menu_glyph.c.o(.bss);
        build/SLUS_006.28/src/menu_run.c.o(.bss);
        build/SLUS_006.28/src/menu_page.c.o(.bss);
        build/SLUS_006.28/src/menu_places.c.o(.bss);
        build/SLUS_006.28/src/menu_card.c.o(.bss);
        build/SLUS_006.28/src/menu_option.c.o(.bss);
        build/SLUS_006.28/src/menu_nowalk.c.o(.bss);
        build/SLUS_006.28/src/face_list.c.o(.bss);
        build/SLUS_006.28/src/menu_use.c.o(.bss);
        build/SLUS_006.28/src/menu_list.c.o(.bss);
        build/SLUS_006.28/src/map_look.c.o(.bss);
        build/SLUS_006.28/src/map_btl.c.o(.bss);
        build/SLUS_006.28/src/map_touch.c.o(.bss);
        build/SLUS_006.28/src/btl_show.c.o(.bss);
        build/SLUS_006.28/src/btl_item.c.o(.bss);
        build/SLUS_006.28/src/btl_weapon.c.o(.bss);
        build/SLUS_006.28/src/btl_boss.c.o(.bss);
        build/SLUS_006.28/src/btl_show_frame.c.o(.bss);
        build/SLUS_006.28/src/btl_effect.c.o(.bss);
        build/SLUS_006.28/src/libapi_c57.c.o(.bss);
        build/SLUS_006.28/src/libapi_c68.c.o(.bss);
        build/SLUS_006.28/src/libapi_c112.c.o(.bss);
        build/SLUS_006.28/src/libapi_a36.c.o(.bss);
        build/SLUS_006.28/src/libapi_a37.c.o(.bss);
        build/SLUS_006.28/src/libapi_a50.c.o(.bss);
        build/SLUS_006.28/src/libapi_a51.c.o(.bss);
        build/SLUS_006.28/src/libapi_a52.c.o(.bss);
        build/SLUS_006.28/src/libapi_a53.c.o(.bss);
        build/SLUS_006.28/src/libapi_a54.c.o(.bss);
        build/SLUS_006.28/src/libapi_a81.c.o(.bss);
        build/SLUS_006.28/src/libapi_i_heap2.c.o(.bss);
        build/SLUS_006.28/src/libapi_malloc2.c.o(.bss);
        build/SLUS_006.28/src/libapi_free2.c.o(.bss);
        build/SLUS_006.28/src/libc2_bcopy.c.o(.bss);
        build/SLUS_006.28/src/libc2_bzero.c.o(.bss);
        build/SLUS_006.28/src/libc2_memset.c.o(.bss);
        build/SLUS_006.28/src/libc2_strcmp.c.o(.bss);
        build/SLUS_006.28/src/libc2_strcpy.c.o(.bss);
        build/SLUS_006.28/src/libc2_strlen.c.o(.bss);
        build/SLUS_006.28/src/libgpu_sys_1.c.o(.bss);
        build/SLUS_006.28/src/libgpu_sys_2.c.o(.bss);
        build/SLUS_006.28/src/libgpu_sys_3.c.o(.bss);
        build/SLUS_006.28/src/libgpu_sys_4.c.o(.bss);
        build/SLUS_006.28/src/libgpu_sys_5.c.o(.bss);
        build/SLUS_006.28/src/libgpu_sys_6.c.o(.bss);
        build/SLUS_006.28/src/libapi_c73.c.o(.bss);
        build/SLUS_006.28/src/libc2_memcpy.c.o(.bss);
        build/SLUS_006.28/src/libgpu_e01.c.o(.bss);
        build/SLUS_006.28/src/libgpu_e03.c.o(.bss);
        build/SLUS_006.28/src/libgpu_e04.c.o(.bss);
        build/SLUS_006.28/src/libgpu_p00.c.o(.bss);
        build/SLUS_006.28/src/libgpu_p01.c.o(.bss);
        build/SLUS_006.28/src/libgpu_p06.c.o(.bss);
        build/SLUS_006.28/src/libgpu_p10.c.o(.bss);
        build/SLUS_006.28/src/libgpu_p12.c.o(.bss);
        build/SLUS_006.28/src/libgpu_p16.c.o(.bss);
        build/SLUS_006.28/src/libgpu_p26.c.o(.bss);
        build/SLUS_006.28/src/libgpu_p29.c.o(.bss);
        build/SLUS_006.28/src/libgpu_p33.c.o(.bss);
        build/SLUS_006.28/src/libgs_gs_001_1.c.o(.bss);
        build/SLUS_006.28/src/libgs_gs_001_2.c.o(.bss);
        build/SLUS_006.28/src/libgs_gs_001_3.c.o(.bss);
        build/SLUS_006.28/src/libgs_gs_002.c.o(.bss);
        build/SLUS_006.28/src/libgs_gs_003.c.o(.bss);
        build/SLUS_006.28/src/libgs_gs_006.c.o(.bss);
        build/SLUS_006.28/src/libgs_gs_007.c.o(.bss);
        build/SLUS_006.28/src/libapi_counter_1.c.o(.bss);
        build/SLUS_006.28/src/libapi_counter_2.c.o(.bss);
        build/SLUS_006.28/src/libgs_gs_008.c.o(.bss);
        build/SLUS_006.28/src/libgs_gs_010.c.o(.bss);
        build/SLUS_006.28/src/libgs_gs_103.c.o(.bss);
        build/SLUS_006.28/src/libgs_gs_104.c.o(.bss);
        build/SLUS_006.28/src/libgs_gs_107_1.c.o(.bss);
        build/SLUS_006.28/src/libgs_gs_107_2.c.o(.bss);
        build/SLUS_006.28/src/libgs_gs_107_3.c.o(.bss);
        build/SLUS_006.28/src/libgs_gs_111.c.o(.bss);
        build/SLUS_006.28/src/libgs_gs_113.c.o(.bss);
        build/SLUS_006.28/src/libgs_gs_121.c.o(.bss);
        build/SLUS_006.28/src/libgs_gs_122.c.o(.bss);
        build/SLUS_006.28/src/libgs_gs_123.c.o(.bss);
        build/SLUS_006.28/src/libgte_msc00.c.o(.bss);
        build/SLUS_006.28/src/libgte_msc01.c.o(.bss);
        build/SLUS_006.28/src/libgte_mtx_11.c.o(.bss);
        build/SLUS_006.28/src/libgte_reg11.c.o(.bss);
        build/SLUS_006.28/src/libgte_reg12.c.o(.bss);
        build/SLUS_006.28/src/libgte_patchgte.c.o(.bss);
        build/SLUS_006.28/src/libcd_cdrom.c.o(.bss);
        build/SLUS_006.28/src/libcd_toc_1.c.o(.bss);
        build/SLUS_006.28/src/libcd_toc_2.c.o(.bss);
        build/SLUS_006.28/src/libcd_event_1.c.o(.bss);
        build/SLUS_006.28/src/libcd_event_2.c.o(.bss);
        build/SLUS_006.28/src/libapi_a07.c.o(.bss);
        build/SLUS_006.28/src/libcd_sys_1.c.o(.bss);
        build/SLUS_006.28/src/libcd_sys_2.c.o(.bss);
        build/SLUS_006.28/src/libcd_sys_3.c.o(.bss);
        build/SLUS_006.28/src/libcd_sys_4.c.o(.bss);
        build/SLUS_006.28/src/libcd_sys_5.c.o(.bss);
        build/SLUS_006.28/src/libcd_sys_6.c.o(.bss);
        build/SLUS_006.28/src/libcd_sys_7.c.o(.bss);
        build/SLUS_006.28/src/libcd_bios_1.c.o(.bss);
        build/SLUS_006.28/src/libcd_bios_2.c.o(.bss);
        build/SLUS_006.28/src/libcd_bios_3.c.o(.bss);
        build/SLUS_006.28/src/libc2_puts.c.o(.bss);
        build/SLUS_006.28/src/libc2_putchar.c.o(.bss);
        build/SLUS_006.28/src/libc2_ctype.c.o(.bss);
        build/SLUS_006.28/src/libcd_iso9660.c.o(.bss);
        build/SLUS_006.28/src/libc2_strncmp.c.o(.bss);
        build/SLUS_006.28/src/libcd_cdread_1.c.o(.bss);
        build/SLUS_006.28/src/libcd_cdread_2.c.o(.bss);
        build/SLUS_006.28/src/libcd_cdread2_1.c.o(.bss);
        build/SLUS_006.28/src/libcd_cdread2_2.c.o(.bss);
        build/SLUS_006.28/src/libcd_c_002.c.o(.bss);
        build/SLUS_006.28/src/libcd_c_004_1.c.o(.bss);
        build/SLUS_006.28/src/libcd_c_004_2.c.o(.bss);
        build/SLUS_006.28/src/libcd_c_005.c.o(.bss);
        build/SLUS_006.28/src/libcd_c_007.c.o(.bss);
        build/SLUS_006.28/src/libcd_c_008.c.o(.bss);
        build/SLUS_006.28/src/libcd_c_009.c.o(.bss);
        build/SLUS_006.28/src/libcd_c_010.c.o(.bss);
        build/SLUS_006.28/src/libcd_c_011_1.c.o(.bss);
        build/SLUS_006.28/src/libcd_c_011_2.c.o(.bss);
        build/SLUS_006.28/src/libcd_s_002.c.o(.bss);
        build/SLUS_006.28/src/libetc_vsync_1.c.o(.bss);
        build/SLUS_006.28/src/libetc_vsync_2.c.o(.bss);
        build/SLUS_006.28/src/libapi_a91.c.o(.bss);
        build/SLUS_006.28/src/libapi_l10.c.o(.bss);
        build/SLUS_006.28/src/libetc_intr_1.c.o(.bss);
        build/SLUS_006.28/src/libetc_intr_2.c.o(.bss);
        build/SLUS_006.28/src/libapi_c114.c.o(.bss);
        build/SLUS_006.28/src/libapi_a23.c.o(.bss);
        build/SLUS_006.28/src/libapi_a24.c.o(.bss);
        build/SLUS_006.28/src/libapi_a25.c.o(.bss);
        build/SLUS_006.28/src/libc2_setjmp.c.o(.bss);
        build/SLUS_006.28/src/libetc_intr_vb_1.c.o(.bss);
        build/SLUS_006.28/src/libetc_intr_vb_2.c.o(.bss);
        build/SLUS_006.28/src/libetc_intr_dma_1.c.o(.bss);
        build/SLUS_006.28/src/libetc_intr_dma_2.c.o(.bss);
        build/SLUS_006.28/src/libetc_vmode.c.o(.bss);
        build/SLUS_006.28/src/libsnd_ssclose_1.c.o(.bss);
        build/SLUS_006.28/src/libsnd_ssclose_2.c.o(.bss);
        build/SLUS_006.28/src/libsnd_ssend.c.o(.bss);
        build/SLUS_006.28/src/libsnd_ssinit.c.o(.bss);
        build/SLUS_006.28/src/libsnd_ssinit_c.c.o(.bss);
        build/SLUS_006.28/src/libsnd_ssloop.c.o(.bss);
        build/SLUS_006.28/src/libsnd_ssopenq.c.o(.bss);
        build/SLUS_006.28/src/libsnd_cc_0.c.o(.bss);
        build/SLUS_006.28/src/libsnd_cc_6.c.o(.bss);
        build/SLUS_006.28/src/libsnd_cc_7.c.o(.bss);
        build/SLUS_006.28/src/libsnd_cc_10.c.o(.bss);
        build/SLUS_006.28/src/libsnd_cc_11.c.o(.bss);
        build/SLUS_006.28/src/libsnd_cc_64.c.o(.bss);
        build/SLUS_006.28/src/libsnd_cc_91.c.o(.bss);
        build/SLUS_006.28/src/libsnd_cc_98.c.o(.bss);
        build/SLUS_006.28/src/libsnd_cc_99.c.o(.bss);
        build/SLUS_006.28/src/libsnd_cc_100.c.o(.bss);
        build/SLUS_006.28/src/libsnd_cc_101.c.o(.bss);
        build/SLUS_006.28/src/libsnd_cc_121.c.o(.bss);
        build/SLUS_006.28/src/libsnd_de_0.c.o(.bss);
        build/SLUS_006.28/src/libsnd_de_1.c.o(.bss);
        build/SLUS_006.28/src/libsnd_de_2.c.o(.bss);
        build/SLUS_006.28/src/libsnd_de_3.c.o(.bss);
        build/SLUS_006.28/src/libsnd_de_4.c.o(.bss);
        build/SLUS_006.28/src/libsnd_ccadsr.c.o(.bss);
        build/SLUS_006.28/src/libsnd_de_5.c.o(.bss);
        build/SLUS_006.28/src/libsnd_de_6.c.o(.bss);
        build/SLUS_006.28/src/libsnd_de_7.c.o(.bss);
        build/SLUS_006.28/src/libsnd_de_8.c.o(.bss);
        build/SLUS_006.28/src/libsnd_de_9.c.o(.bss);
        build/SLUS_006.28/src/libsnd_de_10.c.o(.bss);
        build/SLUS_006.28/src/libsnd_de_11.c.o(.bss);
        build/SLUS_006.28/src/libsnd_de_12.c.o(.bss);
        build/SLUS_006.28/src/libsnd_de_13.c.o(.bss);
        build/SLUS_006.28/src/libsnd_de_14.c.o(.bss);
        build/SLUS_006.28/src/libsnd_de_15.c.o(.bss);
        build/SLUS_006.28/src/libsnd_de_16.c.o(.bss);
        build/SLUS_006.28/src/libsnd_de_17.c.o(.bss);
        build/SLUS_006.28/src/libsnd_de_18.c.o(.bss);
        build/SLUS_006.28/src/libsnd_de_19.c.o(.bss);
        build/SLUS_006.28/src/libsnd_midibend.c.o(.bss);
        build/SLUS_006.28/src/libsnd_midicc.c.o(.bss);
        build/SLUS_006.28/src/libsnd_midimeta.c.o(.bss);
        build/SLUS_006.28/src/libsnd_midinote.c.o(.bss);
        build/SLUS_006.28/src/libsnd_midiprog.c.o(.bss);
        build/SLUS_006.28/src/libsnd_miditime.c.o(.bss);
        build/SLUS_006.28/src/libsnd_seqinit.c.o(.bss);
        build/SLUS_006.28/src/libsnd_ssplay.c.o(.bss);
        build/SLUS_006.28/src/libsnd_playmode.c.o(.bss);
        build/SLUS_006.28/src/libsnd_ssstart_1.c.o(.bss);
        build/SLUS_006.28/src/libsnd_ssstart_2.c.o(.bss);
        build/SLUS_006.28/src/libsnd_ssstart_3.c.o(.bss);
        build/SLUS_006.28/src/libsnd_ssstart_4.c.o(.bss);
        build/SLUS_006.28/src/libsnd_sscall.c.o(.bss);
        build/SLUS_006.28/src/libsnd_cres.c.o(.bss);
        build/SLUS_006.28/src/libsnd_pause.c.o(.bss);
        build/SLUS_006.28/src/libsnd_play.c.o(.bss);
        build/SLUS_006.28/src/libsnd_midiread.c.o(.bss);
        build/SLUS_006.28/src/libsnd_next.c.o(.bss);
        build/SLUS_006.28/src/libsnd_replay.c.o(.bss);
        build/SLUS_006.28/src/libsnd_ssstop_1.c.o(.bss);
        build/SLUS_006.28/src/libsnd_ssstop_2.c.o(.bss);
        build/SLUS_006.28/src/libsnd_sstable.c.o(.bss);
        build/SLUS_006.28/src/libsnd_sstick.c.o(.bss);
        build/SLUS_006.28/src/libsnd_ssvol.c.o(.bss);
        build/SLUS_006.28/src/libsnd_tempo.c.o(.bss);
        build/SLUS_006.28/src/libsnd_ut_gpa.c.o(.bss);
        build/SLUS_006.28/src/libsnd_ut_gva.c.o(.bss);
        build/SLUS_006.28/src/libsnd_ut_rdel.c.o(.bss);
        build/SLUS_006.28/src/libsnd_ut_rdep.c.o(.bss);
        build/SLUS_006.28/src/libsnd_ut_rev.c.o(.bss);
        build/SLUS_006.28/src/libsnd_ut_rfb.c.o(.bss);
        build/SLUS_006.28/src/libsnd_ut_roff.c.o(.bss);
        build/SLUS_006.28/src/libsnd_ut_ron.c.o(.bss);
        build/SLUS_006.28/src/libsnd_ut_sva.c.o(.bss);
        build/SLUS_006.28/src/libsnd_vm_doff.c.o(.bss);
        build/SLUS_006.28/src/libsnd_vm_don.c.o(.bss);
        build/SLUS_006.28/src/libsnd_vm_f.c.o(.bss);
        build/SLUS_006.28/src/libsnd_vm_init.c.o(.bss);
        build/SLUS_006.28/src/libsnd_vm_key_1.c.o(.bss);
        build/SLUS_006.28/src/libsnd_vm_key_2.c.o(.bss);
        build/SLUS_006.28/src/libsnd_vm_aloc1.c.o(.bss);
        build/SLUS_006.28/src/libsnd_vm_aloc2.c.o(.bss);
        build/SLUS_006.28/src/libsnd_vm_n2p.c.o(.bss);
        build/SLUS_006.28/src/libsnd_vm_no1.c.o(.bss);
        build/SLUS_006.28/src/libsnd_vm_noff.c.o(.bss);
        build/SLUS_006.28/src/libsnd_vm_nowof.c.o(.bss);
        build/SLUS_006.28/src/libsnd_vm_nowon.c.o(.bss);
        build/SLUS_006.28/src/libsnd_vm_pb.c.o(.bss);
        build/SLUS_006.28/src/libsnd_vm_prog.c.o(.bss);
        build/SLUS_006.28/src/libsnd_vm_seq.c.o(.bss);
        build/SLUS_006.28/src/libsnd_vm_stav.c.o(.bss);
        build/SLUS_006.28/src/libsnd_vm_vol.c.o(.bss);
        build/SLUS_006.28/src/libsnd_vm_vsu.c.o(.bss);
        build/SLUS_006.28/src/libsnd_vs_mono.c.o(.bss);
        build/SLUS_006.28/src/libsnd_vs_vab.c.o(.bss);
        build/SLUS_006.28/src/libsnd_vs_vh2.c.o(.bss);
        build/SLUS_006.28/src/libsnd_vs_vh.c.o(.bss);
        build/SLUS_006.28/src/libsnd_vs_vtb.c.o(.bss);
        build/SLUS_006.28/src/libsnd_vs_vtc.c.o(.bss);
        build/SLUS_006.28/src/libspu_s_i.c.o(.bss);
        build/SLUS_006.28/src/libspu_s_ini_1.c.o(.bss);
        build/SLUS_006.28/src/libspu_s_ini_2.c.o(.bss);
        build/SLUS_006.28/src/libapi_a08.c.o(.bss);
        build/SLUS_006.28/src/libapi_a12.c.o(.bss);
        build/SLUS_006.28/src/libspu_spu_1.c.o(.bss);
        build/SLUS_006.28/src/libspu_spu_2.c.o(.bss);
        build/SLUS_006.28/src/libspu_spu_3.c.o(.bss);
        build/SLUS_006.28/src/libspu_s_dcb.c.o(.bss);
        build/SLUS_006.28/src/libspu_s_m_init.c.o(.bss);
        build/SLUS_006.28/src/libspu_s_m_m.c.o(.bss);
        build/SLUS_006.28/src/libspu_s_m_int.c.o(.bss);
        build/SLUS_006.28/src/libspu_s_m_f.c.o(.bss);
        build/SLUS_006.28/src/libspu_s_snv.c.o(.bss);
        build/SLUS_006.28/src/libspu_s_sav.c.o(.bss);
        build/SLUS_006.28/src/libspu_s_gnv.c.o(.bss);
        build/SLUS_006.28/src/libspu_s_gav.c.o(.bss);
        build/SLUS_006.28/src/libspu_s_snc.c.o(.bss);
        build/SLUS_006.28/src/libspu_s_sr.c.o(.bss);
        build/SLUS_006.28/src/libspu_s_m_util.c.o(.bss);
        build/SLUS_006.28/src/libspu_s_srmp.c.o(.bss);
        build/SLUS_006.28/src/libspu_s_sra.c.o(.bss);
        build/SLUS_006.28/src/libspu_s_srv.c.o(.bss);
        build/SLUS_006.28/src/libspu_s_grv.c.o(.bss);
        build/SLUS_006.28/src/libspu_s_crwa.c.o(.bss);
        build/SLUS_006.28/src/libapi_a10.c.o(.bss);
        build/SLUS_006.28/src/libspu_s_sk.c.o(.bss);
        build/SLUS_006.28/src/libspu_s_r.c.o(.bss);
        build/SLUS_006.28/src/libspu_s_stsa.c.o(.bss);
        build/SLUS_006.28/src/libspu_s_stm.c.o(.bss);
        build/SLUS_006.28/src/libspu_s_itc.c.o(.bss);
        build/SLUS_006.28/src/libapi_a11.c.o(.bss);
        build/SLUS_006.28/src/libspu_s_it.c.o(.bss);
        build/SLUS_006.28/src/libspu_s_sva.c.o(.bss);
        build/SLUS_006.28/src/libspu_s_n2p.c.o(.bss);
        build/SLUS_006.28/src/libspu_s_gvex.c.o(.bss);
        build/SLUS_006.28/src/libspu_s_scmv.c.o(.bss);
        build/SLUS_006.28/src/libspu_s_sccv.c.o(.bss);
        build/SLUS_006.28/src/libspu_s_sccr.c.o(.bss);
        build/SLUS_006.28/src/libspu_s_sccm.c.o(.bss);
        build/SLUS_006.28/src/libspu_s_srmt.c.o(.bss);
        build/SLUS_006.28/src/libspu_s_srmd.c.o(.bss);
        build/SLUS_006.28/src/libmcrd_init.c.o(.bss);
        build/SLUS_006.28/src/libcard_init.c.o(.bss);
        build/SLUS_006.28/src/libapi_pad_1.c.o(.bss);
        build/SLUS_006.28/src/libapi_pad_2.c.o(.bss);
        build/SLUS_006.28/src/libapi_pad_3.c.o(.bss);
        build/SLUS_006.28/src/libapi_pad_4.c.o(.bss);
        build/SLUS_006.28/src/libapi_a18.c.o(.bss);
        build/SLUS_006.28/src/libapi_a19.c.o(.bss);
        build/SLUS_006.28/src/libapi_a20.c.o(.bss);
        build/SLUS_006.28/src/libapi_a21.c.o(.bss);
        build/SLUS_006.28/src/libapi_l02.c.o(.bss);
        build/SLUS_006.28/src/libapi_l03.c.o(.bss);
        build/SLUS_006.28/src/libapi_patch.c.o(.bss);
        build/SLUS_006.28/src/libapi_chclrpad.c.o(.bss);
        build/SLUS_006.28/src/libcard_a74.c.o(.bss);
        build/SLUS_006.28/src/libcard_a75.c.o(.bss);
        build/SLUS_006.28/src/libcard_a76.c.o(.bss);
        build/SLUS_006.28/src/libcard_patch.c.o(.bss);
        build/SLUS_006.28/src/libcard_end.c.o(.bss);
        build/SLUS_006.28/src/libmcrd_libmcrd_1.c.o(.bss);
        build/SLUS_006.28/src/libmcrd_libmcrd_2.c.o(.bss);
        build/SLUS_006.28/src/libmcrd_libmcrd_3.c.o(.bss);
        build/SLUS_006.28/src/libmcrd_libmcrd_4.c.o(.bss);
        build/SLUS_006.28/src/libmcrd_libmcrd_5.c.o(.bss);
        build/SLUS_006.28/src/libmcrd_libmcrd_6.c.o(.bss);
        build/SLUS_006.28/src/libmcrd_libmcrd_7.c.o(.bss);
        build/SLUS_006.28/src/libmcrd_libmcrd_8.c.o(.bss);
        build/SLUS_006.28/src/libmcrd_libmcrd_9.c.o(.bss);
        build/SLUS_006.28/src/libmcrd_libmcrd_10.c.o(.bss);
        build/SLUS_006.28/src/libmcrd_libmcrd_11.c.o(.bss);
        build/SLUS_006.28/src/libmcrd_libmcrd_12.c.o(.bss);
        build/SLUS_006.28/src/libmcrd_libmcrd_13.c.o(.bss);
        build/SLUS_006.28/src/libapi_a67.c.o(.bss);
        build/SLUS_006.28/src/libapi_a69.c.o(.bss);
        build/SLUS_006.28/src/libapi_first.c.o(.bss);
        build/SLUS_006.28/src/libapi_a66.c.o(.bss);
        build/SLUS_006.28/src/libc2_strcat.c.o(.bss);
        build/SLUS_006.28/src/libcard_c171.c.o(.bss);
        build/SLUS_006.28/src/libcard_c172.c.o(.bss);
        build/SLUS_006.28/src/libcard_a78.c.o(.bss);
        build/SLUS_006.28/src/libcard_a80.c.o(.bss);
        build/SLUS_006.28/src/libcard_card.c.o(.bss);
        build/SLUS_006.28/src/libmcrd_userfunc_1.c.o(.bss);
        build/SLUS_006.28/src/libmcrd_userfunc_2.c.o(.bss);
        build/SLUS_006.28/src/libmcrd_userfunc_3.c.o(.bss);
        build/SLUS_006.28/src/libmcrd_bios_1.c.o(.bss);
        build/SLUS_006.28/src/libmcrd_bios_2.c.o(.bss);
        build/SLUS_006.28/src/libmcrd_bios_3.c.o(.bss);
        build/SLUS_006.28/src/libmcrd_bios_4.c.o(.bss);
        build/SLUS_006.28/src/libmcrd_bios_5.c.o(.bss);
        build/SLUS_006.28/src/libmcrd_bios_6.c.o(.bss);
        build/SLUS_006.28/src/libmcrd_bios_7.c.o(.bss);
        build/SLUS_006.28/src/libapi_a09.c.o(.bss);
        build/SLUS_006.28/src/libmcrd_low.c.o(.bss);
        build/SLUS_006.28/src/libc2_strncpy.c.o(.bss);
        build/SLUS_006.28/src/libcard_a79.c.o(.bss);
        build/SLUS_006.28/src/libpad_padentry_1.c.o(.bss);
        build/SLUS_006.28/src/libpad_padentry_2.c.o(.bss);
        build/SLUS_006.28/src/libpad_padmain.c.o(.bss);
        build/SLUS_006.28/src/libpad_padcmd.c.o(.bss);
        build/SLUS_006.28/src/libpad_padif.c.o(.bss);
        build/SLUS_006.28/src/libpad_padportd.c.o(.bss);
        build/SLUS_006.28/src/libpad_padseqd.c.o(.bss);
        build/SLUS_006.28/src/libpad_waitrc2.c.o(.bss);
        . = ALIGN(., 16);
        main_BSS_END = .;
        main_BSS_SIZE = ABSOLUTE(main_BSS_END - main_BSS_START);
    }
    __romPos += SIZEOF(.main);
    __romPos = ALIGN(__romPos, 16);
    . = ALIGN(., 16);
    main_ROM_END = __romPos;
    main_VRAM_END = .;

    /DISCARD/ :
    {
        *(*);
    }
}
